//=========================================================
// src/InitDevice.c: generated by Hardware Configurator
//
// This file will be regenerated when saving a document.
// leave the sections inside the "$[...]" comment tags alone
// or they will be overwritten!
//=========================================================

// USER INCLUDES
#include <SI_EFM8SB2_Register_Enums.h>
#include "InitDevice.h"

// USER PROTOTYPES
// USER FUNCTIONS

// $[Library Includes]
// [Library Includes]$

//==============================================================================
// enter_SleepMode_from_RESET
//==============================================================================
extern void enter_SleepMode_from_RESET(void) {
	// $[Config Calls]
	// Save the SFRPAGE
	uint8_t SFRPAGE_save = SFRPAGE;
	PCA_0_enter_SleepMode_from_RESET();
	PCACH_5_enter_SleepMode_from_RESET();
	VREG_0_enter_SleepMode_from_RESET();
	ADC_0_enter_SleepMode_from_RESET();
	VREF_0_enter_SleepMode_from_RESET();
	PORTS_0_enter_SleepMode_from_RESET();
	PORTS_1_enter_SleepMode_from_RESET();
	PORTS_2_enter_SleepMode_from_RESET();
	PBCFG_0_enter_SleepMode_from_RESET();
	RSTSRC_0_enter_SleepMode_from_RESET();
	RTC_0_enter_SleepMode_from_RESET();
	CLOCK_0_enter_SleepMode_from_RESET();
	FLASH_0_enter_SleepMode_from_RESET();
	TIMER_SETUP_0_enter_SleepMode_from_RESET();
	SMBUS_0_enter_SleepMode_from_RESET();
	INTERRUPT_0_enter_SleepMode_from_RESET();
	PMU_0_enter_SleepMode_from_RESET();
	// Restore the SFRPAGE
	SFRPAGE = SFRPAGE_save;
	// [Config Calls]$

}

//================================================================================
// PCA_0_enter_SleepMode_from_RESET
//================================================================================
extern void PCA_0_enter_SleepMode_from_RESET(void) {
	// $[PCA0MD - PCA Mode]
	/***********************************************************************
	 - Disable Watchdog Timer
	 - System clock
	 - PCA continues to function normally while the system controller is in
	 Idle Mode
	 - Disable the CF interrupt
	 - Disable Watchdog Timer
	 - Watchdog Timer Enable unlocked
	 ***********************************************************************/
	SFRPAGE = 0x00;
	PCA0MD &= ~PCA0MD_WDTE__BMASK;
	PCA0MD = PCA0MD_CPS__SYSCLK | PCA0MD_CIDL__NORMAL
			| PCA0MD_ECF__OVF_INT_DISABLED | PCA0MD_WDTE__DISABLED
			| PCA0MD_WDLCK__UNLOCKED;
	// [PCA0MD - PCA Mode]$

	// $[PCA0H - PCA Counter/Timer High Byte]
	// [PCA0H - PCA Counter/Timer High Byte]$

	// $[PCA0L - PCA Counter/Timer Low Byte]
	// [PCA0L - PCA Counter/Timer Low Byte]$

	// $[PCA0PWM - PCA PWM Configuration]
	// [PCA0PWM - PCA PWM Configuration]$

	// $[PCA0CN0 - PCA Control 0]
	// [PCA0CN0 - PCA Control 0]$

}

//================================================================================
// PCACH_5_enter_SleepMode_from_RESET
//================================================================================
extern void PCACH_5_enter_SleepMode_from_RESET(void) {
	// $[PCA0 Settings Save]
	// Select Capture/Compare register)
	PCA0PWM &= ~PCA0PWM_ARSEL__BMASK;
	// [PCA0 Settings Save]$

	// $[PCA0CPM5 - PCA Channel 5 Capture/Compare Mode]
	/***********************************************************************
	 - Disable negative edge capture
	 - Disable CCF5 interrupts
	 - Enable match function
	 - 8 to 11-bit PWM selected
	 - Disable positive edge capture
	 - Disable comparator function
	 - Disable PWM function
	 - Disable toggle function
	 ***********************************************************************/
	PCA0CPM5 = PCA0CPM5_CAPN__DISABLED | PCA0CPM5_ECCF__DISABLED
			| PCA0CPM5_MAT__ENABLED | PCA0CPM5_PWM16__8_BIT
			| PCA0CPM5_CAPP__DISABLED | PCA0CPM5_ECOM__DISABLED
			| PCA0CPM5_PWM__DISABLED | PCA0CPM5_TOG__DISABLED;
	// [PCA0CPM5 - PCA Channel 5 Capture/Compare Mode]$

	// $[PCA0CPL5 - PCA Channel 5 Capture Module Low Byte]
	// [PCA0CPL5 - PCA Channel 5 Capture Module Low Byte]$

	// $[PCA0CPH5 - PCA Channel 5 Capture Module High Byte]
	PCA0CPH5 = 0x00;
	// [PCA0CPH5 - PCA Channel 5 Capture Module High Byte]$

	// $[Auto-reload]
	// [Auto-reload]$

	// $[PCA0 Settings Restore]
	// [PCA0 Settings Restore]$

}

//================================================================================
// VREG_0_enter_SleepMode_from_RESET
//================================================================================
extern void VREG_0_enter_SleepMode_from_RESET(void) {
	// $[REG0CN - Voltage Regulator Control]
	/***********************************************************************
	 - Allow the hardware to enable the precision High Frequency Oscillator
	 bias whenever its needed
	 ***********************************************************************/
	REG0CN = REG0CN_OSCBIAS__ENABLE_WHEN_NEEDED;
	// [REG0CN - Voltage Regulator Control]$

}

//================================================================================
// ADC_0_enter_SleepMode_from_RESET
//================================================================================
extern void ADC_0_enter_SleepMode_from_RESET(void) {
	// $[ADC0MX - ADC0 Multiplexer Selection]
	/***********************************************************************
	 - Select channel ADC0.1
	 ***********************************************************************/
	ADC0MX = ADC0MX_ADC0MX__ADC0P1;
	// [ADC0MX - ADC0 Multiplexer Selection]$

	// $[ADC0AC - ADC0 Accumulator Configuration]
	// [ADC0AC - ADC0 Accumulator Configuration]$

	// $[ADC0TK - ADC0 Burst Mode Track Time]
	// [ADC0TK - ADC0 Burst Mode Track Time]$

	// $[ADC0PWR - ADC0 Power Control]
	// [ADC0PWR - ADC0 Power Control]$

	// $[ADC0CF - ADC0 Configuration]
	/***********************************************************************
	 - ADC0 operates in 10-bit mode 
	 - The on-chip PGA gain is 1
	 - SAR Clock Divider = 0x02
	 - Normal Track Mode
	 ***********************************************************************/
	ADC0CF = ADC0CF_AD8BE__NORMAL | ADC0CF_ADGN__GAIN_1
			| (0x02 << ADC0CF_ADSC__SHIFT) | ADC0CF_ADTM__TRACK_NORMAL;
	// [ADC0CF - ADC0 Configuration]$

	// $[ADC0GTH - ADC0 Greater-Than High Byte]
	/***********************************************************************
	 - Greater-Than High Byte = 0x00
	 ***********************************************************************/
	ADC0GTH = (0x00 << ADC0GTH_ADC0GTH__SHIFT);
	// [ADC0GTH - ADC0 Greater-Than High Byte]$

	// $[ADC0GTL - ADC0 Greater-Than Low Byte]
	/***********************************************************************
	 - Greater-Than Low Byte = 0x00
	 ***********************************************************************/
	ADC0GTL = (0x00 << ADC0GTL_ADC0GTL__SHIFT);
	// [ADC0GTL - ADC0 Greater-Than Low Byte]$

	// $[ADC0LTH - ADC0 Less-Than High Byte]
	// [ADC0LTH - ADC0 Less-Than High Byte]$

	// $[ADC0LTL - ADC0 Less-Than Low Byte]
	// [ADC0LTL - ADC0 Less-Than Low Byte]$

	// $[ADC0CN0 - ADC0 Control 0]
	// [ADC0CN0 - ADC0 Control 0]$

}

//================================================================================
// VREF_0_enter_SleepMode_from_RESET
//================================================================================
extern void VREF_0_enter_SleepMode_from_RESET(void) {
	// $[REF0CN - Voltage Reference Control]
	/***********************************************************************
	 - Disable the Temperature Sensor
	 - The ADC0 ground reference is the GND pin
	 - Internal 1.68 V Precision Voltage Reference disabled and not connected
	 to VREF
	 - The ADC0 voltage reference is the P0.0/VREF pin
	 ***********************************************************************/
	REF0CN = REF0CN_TEMPE__TEMP_DISABLED | REF0CN_GNDSL__GND_PIN
			| REF0CN_REFOE__DISABLED | REF0CN_REFSL__VREF_PIN;
	// [REF0CN - Voltage Reference Control]$

}

//================================================================================
// PORTS_0_enter_SleepMode_from_RESET
//================================================================================
extern void PORTS_0_enter_SleepMode_from_RESET(void) {
	// $[P0 - Port 0 Pin Latch]
	// [P0 - Port 0 Pin Latch]$

	// $[P0MDOUT - Port 0 Output Mode]
	// [P0MDOUT - Port 0 Output Mode]$

	// $[P0MDIN - Port 0 Input Mode]
	/***********************************************************************
	 - P0.0 pin is configured for analog mode
	 - P0.1 pin is configured for analog mode
	 - P0.2 pin is configured for analog mode
	 - P0.3 pin is configured for analog mode
	 - P0.4 pin is configured for analog mode
	 - P0.5 pin is configured for digital mode
	 - P0.6 pin is configured for digital mode
	 - P0.7 pin is configured for digital mode
	 ***********************************************************************/
	P0MDIN = P0MDIN_B0__ANALOG | P0MDIN_B1__ANALOG | P0MDIN_B2__ANALOG
			| P0MDIN_B3__ANALOG | P0MDIN_B4__ANALOG | P0MDIN_B5__DIGITAL
			| P0MDIN_B6__DIGITAL | P0MDIN_B7__DIGITAL;
	// [P0MDIN - Port 0 Input Mode]$

	// $[P0SKIP - Port 0 Skip]
	/***********************************************************************
	 - P0.0 pin is skipped by the crossbar
	 - P0.1 pin is skipped by the crossbar
	 - P0.2 pin is skipped by the crossbar
	 - P0.3 pin is skipped by the crossbar
	 - P0.4 pin is skipped by the crossbar
	 - P0.5 pin is skipped by the crossbar
	 - P0.6 pin is skipped by the crossbar
	 - P0.7 pin is skipped by the crossbar
	 ***********************************************************************/
	P0SKIP = P0SKIP_B0__SKIPPED | P0SKIP_B1__SKIPPED | P0SKIP_B2__SKIPPED
			| P0SKIP_B3__SKIPPED | P0SKIP_B4__SKIPPED | P0SKIP_B5__SKIPPED
			| P0SKIP_B6__SKIPPED | P0SKIP_B7__SKIPPED;
	// [P0SKIP - Port 0 Skip]$

	// $[P0MASK - Port 0 Mask]
	/***********************************************************************
	 - P0.0 pin logic value is ignored and will not cause a port mismatch
	 event
	 - P0.1 pin logic value is ignored and will not cause a port mismatch
	 event
	 - P0.2 pin logic value is ignored and will not cause a port mismatch
	 event
	 - P0.3 pin logic value is ignored and will not cause a port mismatch
	 event
	 - P0.4 pin logic value is ignored and will not cause a port mismatch
	 event
	 - P0.5 pin logic value is ignored and will not cause a port mismatch
	 event
	 - P0.6 pin logic value is ignored and will not cause a port mismatch
	 event
	 - P0.7 pin logic value is compared to P0MAT.7
	 ***********************************************************************/
	P0MASK = P0MASK_B0__IGNORED | P0MASK_B1__IGNORED | P0MASK_B2__IGNORED
			| P0MASK_B3__IGNORED | P0MASK_B4__IGNORED | P0MASK_B5__IGNORED
			| P0MASK_B6__IGNORED | P0MASK_B7__COMPARED;
	// [P0MASK - Port 0 Mask]$

	// $[P0MAT - Port 0 Match]
	/***********************************************************************
	 - P0.0 pin logic value is compared with logic HIGH
	 - P0.1 pin logic value is compared with logic HIGH
	 - P0.2 pin logic value is compared with logic HIGH
	 - P0.3 pin logic value is compared with logic HIGH
	 - P0.4 pin logic value is compared with logic HIGH
	 - P0.5 pin logic value is compared with logic HIGH
	 - P0.6 pin logic value is compared with logic HIGH
	 - P0.7 pin logic value is compared with logic LOW
	 ***********************************************************************/
	P0MAT = P0MAT_B0__HIGH | P0MAT_B1__HIGH | P0MAT_B2__HIGH | P0MAT_B3__HIGH
			| P0MAT_B4__HIGH | P0MAT_B5__HIGH | P0MAT_B6__HIGH | P0MAT_B7__LOW;
	// [P0MAT - Port 0 Match]$

	// $[P0DRV - Port 0 Drive Strength]
	// [P0DRV - Port 0 Drive Strength]$

}

//================================================================================
// PORTS_1_enter_SleepMode_from_RESET
//================================================================================
extern void PORTS_1_enter_SleepMode_from_RESET(void) {
	// $[P1 - Port 1 Pin Latch]
	/***********************************************************************
	 - P1.0 is high. Set P1.0 to drive or float high
	 - P1.1 is high. Set P1.1 to drive or float high
	 - P1.2 is high. Set P1.2 to drive or float high
	 - P1.3 is low. Set P1.3 to drive low
	 - P1.4 is low. Set P1.4 to drive low
	 - P1.5 is low. Set P1.5 to drive low
	 - P1.6 is low. Set P1.6 to drive low
	 ***********************************************************************/
	P1 = P1_B0__HIGH | P1_B1__HIGH | P1_B2__HIGH | P1_B3__LOW | P1_B4__LOW
			| P1_B5__LOW | P1_B6__LOW;
	// [P1 - Port 1 Pin Latch]$

	// $[P1MDOUT - Port 1 Output Mode]
	/***********************************************************************
	 - P1.0 output is open-drain
	 - P1.1 output is open-drain
	 - P1.2 output is open-drain
	 - P1.3 output is push-pull
	 - P1.4 output is push-pull
	 - P1.5 output is push-pull
	 - P1.6 output is push-pull
	 ***********************************************************************/
	P1MDOUT = P1MDOUT_B0__OPEN_DRAIN | P1MDOUT_B1__OPEN_DRAIN
			| P1MDOUT_B2__OPEN_DRAIN | P1MDOUT_B3__PUSH_PULL
			| P1MDOUT_B4__PUSH_PULL | P1MDOUT_B5__PUSH_PULL
			| P1MDOUT_B6__PUSH_PULL;
	// [P1MDOUT - Port 1 Output Mode]$

	// $[P1MDIN - Port 1 Input Mode]
	// [P1MDIN - Port 1 Input Mode]$

	// $[P1SKIP - Port 1 Skip]
	/***********************************************************************
	 - P1.0 pin is skipped by the crossbar
	 - P1.1 pin is not skipped by the crossbar
	 - P1.2 pin is not skipped by the crossbar
	 - P1.3 pin is skipped by the crossbar
	 - P1.4 pin is not skipped by the crossbar
	 - P1.5 pin is not skipped by the crossbar
	 - P1.6 pin is not skipped by the crossbar
	 ***********************************************************************/
	P1SKIP = P1SKIP_B0__SKIPPED | P1SKIP_B1__NOT_SKIPPED
			| P1SKIP_B2__NOT_SKIPPED | P1SKIP_B3__SKIPPED
			| P1SKIP_B4__NOT_SKIPPED | P1SKIP_B5__NOT_SKIPPED
			| P1SKIP_B6__NOT_SKIPPED;
	// [P1SKIP - Port 1 Skip]$

	// $[P1MASK - Port 1 Mask]
	// [P1MASK - Port 1 Mask]$

	// $[P1MAT - Port 1 Match]
	// [P1MAT - Port 1 Match]$

	// $[P1DRV - Port 1 Drive Strength]
	/***********************************************************************
	 - P1.0 output has low output drive strength
	 - P1.1 output has low output drive strength
	 - P1.2 output has low output drive strength
	 - P1.3 output has high output drive strength
	 - P1.4 output has high output drive strength
	 - P1.5 output has high output drive strength
	 - P1.6 output has high output drive strength
	 ***********************************************************************/
	SFRPAGE = 0x0F;
	P1DRV = P1DRV_B0__LOW_DRIVE | P1DRV_B1__LOW_DRIVE | P1DRV_B2__LOW_DRIVE
			| P1DRV_B3__HIGH_DRIVE | P1DRV_B4__HIGH_DRIVE | P1DRV_B5__HIGH_DRIVE
			| P1DRV_B6__HIGH_DRIVE;
	// [P1DRV - Port 1 Drive Strength]$

}

//================================================================================
// PORTS_2_enter_SleepMode_from_RESET
//================================================================================
extern void PORTS_2_enter_SleepMode_from_RESET(void) {
	// $[P2 - Port 2 Pin Latch]
	// [P2 - Port 2 Pin Latch]$

	// $[P2MDOUT - Port 2 Output Mode]
	// [P2MDOUT - Port 2 Output Mode]$

	// $[P2MDIN - Port 2 Input Mode]
	// [P2MDIN - Port 2 Input Mode]$

	// $[P2SKIP - Port 2 Skip]
	// [P2SKIP - Port 2 Skip]$

	// $[P2DRV - Port 2 Drive Strength]
	// [P2DRV - Port 2 Drive Strength]$

}

//================================================================================
// PBCFG_0_enter_SleepMode_from_RESET
//================================================================================
extern void PBCFG_0_enter_SleepMode_from_RESET(void) {
	// $[XBR2 - Port I/O Crossbar 2]
	/***********************************************************************
	 - Weak Pullups disabled
	 - Crossbar enabled
	 ***********************************************************************/
	SFRPAGE = 0x00;
	XBR2 = XBR2_WEAKPUD__PULL_UPS_DISABLED | XBR2_XBARE__ENABLED;
	// [XBR2 - Port I/O Crossbar 2]$

	// $[XBR0 - Port I/O Crossbar 0]
	/***********************************************************************
	 - UART I/O unavailable at Port pin
	 - SPI I/O unavailable at Port pins
	 - SMBus 0 I/O routed to Port pins
	 - CP0 unavailable at Port pin
	 - Asynchronous CP0 unavailable at Port pin
	 - CP1 unavailable at Port pin
	 - Asynchronous CP1 unavailable at Port pin
	 - SYSCLK unavailable at Port pin
	 ***********************************************************************/
	XBR0 = XBR0_URT0E__DISABLED | XBR0_SPI0E__DISABLED | XBR0_SMB0E__ENABLED
			| XBR0_CP0E__DISABLED | XBR0_CP0AE__DISABLED | XBR0_CP1E__DISABLED
			| XBR0_CP1AE__DISABLED | XBR0_SYSCKE__DISABLED;
	// [XBR0 - Port I/O Crossbar 0]$

	// $[XBR1 - Port I/O Crossbar 1]
	// [XBR1 - Port I/O Crossbar 1]$

}

//================================================================================
// RSTSRC_0_enter_SleepMode_from_RESET
//================================================================================
extern void RSTSRC_0_enter_SleepMode_from_RESET(void) {
	// $[RSTSRC - Reset Source]
	/***********************************************************************
	 - A power-on or supply monitor reset occurred
	 - A missing clock detector reset did not occur
	 - A Comparator 0 reset did not occur
	 - A RTC alarm or oscillator fail reset did not occur
	 ***********************************************************************/
	RSTSRC = RSTSRC_PORSF__SET | RSTSRC_MCDRSF__NOT_SET | RSTSRC_C0RSEF__NOT_SET
			| RSTSRC_RTC0RE__NOT_SET;
	// [RSTSRC - Reset Source]$

}

//================================================================================
// RTC_0_enter_SleepMode_from_RESET
//================================================================================
extern void RTC_0_enter_SleepMode_from_RESET(void) {
	// $[RTC Initialization]
	// A variable for providing a delay for external oscillator startup
	uint16_t delayCounter;
	// Save the system clock (the system clock will be slowed during the startup delay)
	uint8_t CLKSEL_save;
	CLKSEL_save = CLKSEL;

	// Unlock the RTC Interface
	RTC0KEY = RTC0KEY_RTC0ST__KEY1;
	RTC0KEY = RTC0KEY_RTC0ST__KEY2;

	// Enable power to the SmaRTClock oscillator circuit (RTC0EN = 1)
	// [RTC Initialization]$

	// $[RTC0XCN0 - RTC Oscillator Control: Initial start-up setting]
	// Set SmaRTClock to Crystal Mode (XMODE = 1).
	// Disable Automatic Gain Control (AGCEN) and enable Bias Doubling (BIASX2) for fast crystal startup.
	RTC0ADR = RTC0XCN0;
	RTC0DAT = RTC0XCN0_XMODE__CRYSTAL | RTC0XCN0_BIASX2__ENABLED;
	while ((RTC0ADR & RTC0ADR_BUSY__BMASK) == RTC0ADR_BUSY__SET)
		;    //Poll Busy Bit
	// [RTC0XCN0 - RTC Oscillator Control: Initial start-up setting]$

	// $[RTC0XCF - RTC Oscillator Configuration]
	/***********************************************************************
	 - Disable load capacitance stepping
	 - Load Capacitance Programmed Value = 0x0E
	 ***********************************************************************/
	RTC0ADR = RTC0XCF;
	RTC0DAT = RTC0XCF_AUTOSTP__DISABLED | (0x0E << RTC0XCF_LOADCAP__SHIFT);
	while ((RTC0ADR & RTC0ADR_BUSY__BMASK) == RTC0ADR_BUSY__SET)
		;    //Poll Busy Bit
	// [RTC0XCF - RTC Oscillator Configuration]$

	// $[RTC0PIN - RTC Pin Configuration]
	// [RTC0PIN - RTC Pin Configuration]$

	// $[CAPTURE0 - RTC Timer Capture 0]
	// [CAPTURE0 - RTC Timer Capture 0]$

	// $[CAPTURE1 - RTC Timer Capture 1]
	// [CAPTURE1 - RTC Timer Capture 1]$

	// $[CAPTURE2 - RTC Timer Capture 2]
	// [CAPTURE2 - RTC Timer Capture 2]$

	// $[CAPTURE3 - RTC Timer Capture 3]
	// [CAPTURE3 - RTC Timer Capture 3]$

	// $[ALARM0 - RTC Alarm Programmed Value 0]
	/***********************************************************************
	 - RTC Alarm Programmed Value 0 = 0xFE
	 ***********************************************************************/
	RTC0ADR = ALARM0;
	RTC0DAT = (0xFE << ALARM0_ALARM0__SHIFT);
	while ((RTC0ADR & RTC0ADR_BUSY__BMASK) == RTC0ADR_BUSY__SET)
		;    //Poll Busy Bit
	// [ALARM0 - RTC Alarm Programmed Value 0]$

	// $[ALARM1 - RTC Alarm Programmed Value 1]
	/***********************************************************************
	 - RTC Alarm Programmed Value 1 = 0x7F
	 ***********************************************************************/
	RTC0ADR = ALARM1;
	RTC0DAT = (0x7F << ALARM1_ALARM1__SHIFT);
	while ((RTC0ADR & RTC0ADR_BUSY__BMASK) == RTC0ADR_BUSY__SET)
		;    //Poll Busy Bit
	// [ALARM1 - RTC Alarm Programmed Value 1]$

	// $[ALARM2 - RTC Alarm Programmed Value 2]
	// [ALARM2 - RTC Alarm Programmed Value 2]$

	// $[ALARM3 - RTC Alarm Programmed Value 3]
	// [ALARM3 - RTC Alarm Programmed Value 3]$

	// $[RTC0CN - RTC Control]
	/***********************************************************************
	 - Enable RTC oscillator
	 ***********************************************************************/
	RTC0ADR = RTC0CN0;
	RTC0DAT = 0;
	while ((RTC0ADR & RTC0ADR_BUSY__BMASK) == RTC0ADR_BUSY__SET)
		;    //Poll Busy Bit

	RTC0ADR = RTC0CN0;
	RTC0DAT |= RTC0CN0_RTC0EN__ENABLED;
	while ((RTC0ADR & RTC0ADR_BUSY__BMASK) == RTC0ADR_BUSY__SET)
		;    //Poll Busy Bit

	// [RTC0CN - RTC Control]$

	// $[External Oscillator Setup]
	// Set the clock to a known value for the delay
	CLKSEL = CLKSEL_CLKSL__LPOSC | CLKSEL_CLKDIV__SYSCLK_DIV_128;

	// Delay for > 20 ms
	for (delayCounter = 0x150; delayCounter != 0; delayCounter--)
		;

	// Poll the SmaRTClock Clock Valid Bit (CLKVLD) until the crystal oscillator stabilizes
	do {
		RTC0ADR = RTC0ADR_BUSY__SET | RTC0ADR_ADDR__RTC0XCN0;
		while ((RTC0ADR & RTC0ADR_BUSY__BMASK) == RTC0ADR_BUSY__SET)
			;    //Poll Busy Bit
	} while ((RTC0DAT & RTC0XCN0_CLKVLD__BMASK) == RTC0XCN0_CLKVLD__NOT_SET);

	// Enable Automatic Gain Control (AGCEN) and disable Bias Doubling (BIASX2) for maximum power savings
	/***********************************************************************
	 - Crystal Mode selected
	 - Disable AGC
	 - Disable the Bias Double feature
	 ***********************************************************************/
	RTC0ADR = RTC0XCN0;
	RTC0DAT = RTC0XCN0_XMODE__CRYSTAL | RTC0XCN0_AGCEN__DISABLED
			| RTC0XCN0_BIASX2__DISABLED;
	while ((RTC0ADR & RTC0ADR_BUSY__BMASK) == RTC0ADR_BUSY__SET)
		;    //Poll Busy Bit

	// Enable the SmaRTClock missing clock detector.
	RTC0ADR = RTC0CN0;

	// Delay for > 2 ms
	for (delayCounter = 0x100; delayCounter != 0; delayCounter--)
		;

	// Clear PMU wake-up source flags
	PMU0CF = PMU0CF_CLEAR__ALL_FLAGS;

	// Restore system clock
	CLKSEL = CLKSEL_save;
	// Poll CLKRDY to wait for the clock to stabilize
	while (!((CLKSEL & CLKSEL_CLKRDY__BMASK) == CLKSEL_CLKRDY__SET))
		;

	/***********************************************************************
	 - Enable RTC oscillator
	 - RTC timer is running
	 - Disable missing RTC detector
	 - Enable RTC alarm
	 - Alarm event flag is set or enable the auto reset function
	 - Do not start a capture operation
	 - Do not start a set operation
	 ***********************************************************************/
	RTC0ADR = RTC0CN0;
	RTC0DAT = RTC0CN0_RTC0EN__ENABLED | RTC0CN0_RTC0TR__RUN
			| RTC0CN0_MCLKEN__DISABLED | RTC0CN0_RTC0AEN__ENABLED
			| RTC0CN0_ALRM__SET | RTC0CN0_RTC0CAP__NOT_SET
			| RTC0CN0_RTC0SET__NOT_SET;
	while ((RTC0ADR & RTC0ADR_BUSY__BMASK) == RTC0ADR_BUSY__SET)
		;    //Poll Busy Bit

	// [External Oscillator Setup]$

}

//================================================================================
// CLOCK_0_enter_SleepMode_from_RESET
//================================================================================
extern void CLOCK_0_enter_SleepMode_from_RESET(void) {
	// $[CLKSEL - Clock Select]
	/***********************************************************************
	 - SYSCLK is equal to selected clock source divided by 1
	 - Clock derived from the Internal Low Power Oscillator
	 ***********************************************************************/
	CLKSEL = CLKSEL_CLKDIV__SYSCLK_DIV_1 | CLKSEL_CLKSL__LPOSC;
	// Wait for the clock to be ready
	while ((CLKSEL & CLKSEL_CLKRDY__BMASK) != CLKSEL_CLKRDY__SET)
		;
	// [CLKSEL - Clock Select]$

}

//================================================================================
// FLASH_0_enter_SleepMode_from_RESET
//================================================================================
extern void FLASH_0_enter_SleepMode_from_RESET(void) {
	// $[FLSCL - Flash Scale]
	/***********************************************************************
	 - The system clock determines the flash read time
	 ***********************************************************************/
	FLSCL = FLSCL_BYPASS__SYSCLK;
	// [FLSCL - Flash Scale]$

}

//================================================================================
// TIMER_SETUP_0_enter_SleepMode_from_RESET
//================================================================================
extern void TIMER_SETUP_0_enter_SleepMode_from_RESET(void) {
	// $[CKCON0 - Clock Control 0]
	/***********************************************************************
	 - System clock divided by 12
	 - Counter/Timer 0 uses the system clock
	 - Timer 2 high byte uses the clock defined by T2XCLK in TMR2CN0
	 - Timer 2 low byte uses the clock defined by T2XCLK in TMR2CN0
	 - Timer 3 high byte uses the clock defined by T3XCLK in TMR3CN0
	 - Timer 3 low byte uses the clock defined by T3XCLK in TMR3CN0
	 - Timer 1 uses the clock defined by the prescale field, SCA
	 ***********************************************************************/
	CKCON0 = CKCON0_SCA__SYSCLK_DIV_12 | CKCON0_T0M__SYSCLK
			| CKCON0_T2MH__EXTERNAL_CLOCK | CKCON0_T2ML__EXTERNAL_CLOCK
			| CKCON0_T3MH__EXTERNAL_CLOCK | CKCON0_T3ML__EXTERNAL_CLOCK
			| CKCON0_T1M__PRESCALE;
	// [CKCON0 - Clock Control 0]$

	// $[TMOD - Timer 0/1 Mode]
	/***********************************************************************
	 - Mode 2, 8-bit Counter/Timer with Auto-Reload
	 - Mode 0, 13-bit Counter/Timer
	 - Timer Mode
	 - Timer 0 enabled when TR0 = 1 irrespective of INT0 logic level
	 - Timer Mode
	 - Timer 1 enabled when TR1 = 1 irrespective of INT1 logic level
	 ***********************************************************************/
	TMOD = TMOD_T0M__MODE2 | TMOD_T1M__MODE0 | TMOD_CT0__TIMER
			| TMOD_GATE0__DISABLED | TMOD_CT1__TIMER | TMOD_GATE1__DISABLED;
	// [TMOD - Timer 0/1 Mode]$

	// $[TCON - Timer 0/1 Control]
	// [TCON - Timer 0/1 Control]$

}

//================================================================================
// SMBUS_0_enter_SleepMode_from_RESET
//================================================================================
extern void SMBUS_0_enter_SleepMode_from_RESET(void) {
	// $[SMB0ADR - SMBus 0 Slave Address]
	// [SMB0ADR - SMBus 0 Slave Address]$

	// $[SMB0ADM - SMBus 0 Slave Address Mask]
	// [SMB0ADM - SMBus 0 Slave Address Mask]$

	// $[SMB0CF - SMBus 0 Configuration]
	/***********************************************************************
	 - Slave states are inhibited
	 ***********************************************************************/
	SMB0CF |= SMB0CF_INH__SLAVE_DISABLED;
	// [SMB0CF - SMBus 0 Configuration]$

}

//================================================================================
// INTERRUPT_0_enter_SleepMode_from_RESET
//================================================================================
extern void INTERRUPT_0_enter_SleepMode_from_RESET(void) {
	// $[EIE1 - Extended Interrupt Enable 1]
	/***********************************************************************
	 - Disable ADC0 Conversion Complete interrupt
	 - Disable ADC0 Window Comparison interrupt
	 - Disable CP0 interrupts
	 - Disable CP1 interrupts
	 - Disable all PCA0 interrupts
	 - Enable interrupt requests generated by a RTC Alarm
	 - Disable all SMB0 interrupts
	 - Disable Timer 3 interrupts
	 ***********************************************************************/
	EIE1 = EIE1_EADC0__DISABLED | EIE1_EWADC0__DISABLED | EIE1_ECP0__DISABLED
			| EIE1_ECP1__DISABLED | EIE1_EPCA0__DISABLED | EIE1_ERTC0A__ENABLED
			| EIE1_ESMB0__DISABLED | EIE1_ET3__DISABLED;
	// [EIE1 - Extended Interrupt Enable 1]$

	// $[EIP1 - Extended Interrupt Priority 1]
	/***********************************************************************
	 - ADC0 Conversion Complete interrupt set to low priority level
	 - ADC0 Window interrupt set to low priority level
	 - CP0 interrupt set to low priority level
	 - CP1 interrupt set to low priority level
	 - PCA0 interrupt set to low priority level
	 - RTC Alarm interrupt set to high priority level
	 - SMB0 interrupt set to low priority level
	 - Timer 3 interrupts set to low priority level
	 ***********************************************************************/
	EIP1 = EIP1_PADC0__LOW | EIP1_PWADC0__LOW | EIP1_PCP0__LOW | EIP1_PCP1__LOW
			| EIP1_PPCA0__LOW | EIP1_PRTC0A__HIGH | EIP1_PSMB0__LOW
			| EIP1_PT3__LOW;
	// [EIP1 - Extended Interrupt Priority 1]$

	// $[IE - Interrupt Enable]
	/***********************************************************************
	 - Enable each interrupt according to its individual mask setting
	 - Disable external interrupt 0
	 - Disable external interrupt 1
	 - Disable all SPI0 interrupts
	 - Disable all Timer 0 interrupt
	 - Disable all Timer 1 interrupt
	 - Disable Timer 2 interrupt
	 - Disable UART0 interrupt
	 ***********************************************************************/
	IE = IE_EA__ENABLED | IE_EX0__DISABLED | IE_EX1__DISABLED
			| IE_ESPI0__DISABLED | IE_ET0__DISABLED | IE_ET1__DISABLED
			| IE_ET2__DISABLED | IE_ES0__DISABLED;
	// [IE - Interrupt Enable]$

	// $[IP - Interrupt Priority]
	// [IP - Interrupt Priority]$

	// $[EIE2 - Extended Interrupt Enable 2]
	// [EIE2 - Extended Interrupt Enable 2]$

	// $[EIP2 - Extended Interrupt Priority 2]
	// [EIP2 - Extended Interrupt Priority 2]$

}

//================================================================================
// PMU_0_enter_SleepMode_from_RESET
//================================================================================
extern void PMU_0_enter_SleepMode_from_RESET(void) {
	// $[Clock Setup]

	// We must switch to the LPOSC before going into sleep mode
	// Save the clock settings
	uint8_t CLKSEL_save;
	uint8_t HFO0CN_save;
	CLKSEL_save = CLKSEL;
	HFO0CN_save = HFO0CN;

	// Switch to the LPOSC divided by 1
	CLKSEL = CLKSEL_CLKDIV__SYSCLK_DIV_1 | CLKSEL_CLKSL__LPOSC;
	while (!((CLKSEL & CLKSEL_CLKRDY__BMASK) == CLKSEL_CLKRDY__SET))
		;
	HFO0CN &= ~HFO0CN_IOSCEN__BMASK;

	// [Clock Setup]$

	// $[PCON0 - Power Control 0]
	// [PCON0 - Power Control 0]$

	// $[Clear PMU Wake-up flags]
	PMU0CF = PMU0CF_CLEAR__ALL_FLAGS;
	// [Clear PMU Wake-up flags]$

	// $[PMU0CF - Power Management Unit Configuration]
	/***********************************************************************
	 - Place the device in Sleep mode
	 - Suspend mode not activated
	 - Clear all wake-up flags
	 - Comparator 0 rising edge did not cause the last wake-up
	 - A Port Match event caused the last wake-up
	 - A RTC Alarm caused the last wake-up
	 - An RTC oscillator fail event did not cause the last wake-up
	 ***********************************************************************/
	PMU0CF = PMU0CF_SLEEP__START | PMU0CF_SUSPEND__NORMAL
			| PMU0CF_CLEAR__ALL_FLAGS | PMU0CF_CPT0WK__NOT_SET
			| PMU0CF_PMATWK__SET | PMU0CF_RTCAWK__SET | PMU0CF_RTCFWK__NOT_SET;
	NOP();
	NOP(); // Delay to update wake-up flags
	// [PMU0CF - Power Management Unit Configuration]$

	// $[Clock Restore]

	// Restore clock settings
	HFO0CN |= (HFO0CN_save & HFO0CN_IOSCEN__BMASK);
	CLKSEL = CLKSEL_save;
	while (!((CLKSEL & CLKSEL_CLKRDY__BMASK) == CLKSEL_CLKRDY__SET))
		;

	// [Clock Restore]$

}

//==============================================================================
// enter_ClockMode_from_SleepMode
//==============================================================================
extern void enter_ClockMode_from_SleepMode(void) {
	// $[Config Calls]
	// Save the SFRPAGE
	uint8_t SFRPAGE_save = SFRPAGE;
	PCA_0_enter_ClockMode_from_SleepMode();
	ADC_0_enter_ClockMode_from_SleepMode();
	PORTS_0_enter_ClockMode_from_SleepMode();
	PBCFG_0_enter_ClockMode_from_SleepMode();
	PMU_0_enter_ClockMode_from_SleepMode();
	// Restore the SFRPAGE
	SFRPAGE = SFRPAGE_save;
	// [Config Calls]$

}

//================================================================================
// PCA_0_enter_ClockMode_from_SleepMode
//================================================================================
extern void PCA_0_enter_ClockMode_from_SleepMode(void) {
	// $[PCA0MD - PCA Mode]
	/***********************************************************************
	 - System clock divided by 4
	 - PCA continues to function normally while the system controller is in
	 Idle Mode
	 - Disable the CF interrupt
	 - Disable Watchdog Timer
	 - Watchdog Timer Enable unlocked
	 ***********************************************************************/
	SFRPAGE = 0x00;
	PCA0MD = PCA0MD_CPS__SYSCLK_DIV_4 | PCA0MD_CIDL__NORMAL
			| PCA0MD_ECF__OVF_INT_DISABLED | PCA0MD_WDTE__DISABLED
			| PCA0MD_WDLCK__UNLOCKED;
	// [PCA0MD - PCA Mode]$

	// $[PCA0H - PCA Counter/Timer High Byte]
	// [PCA0H - PCA Counter/Timer High Byte]$

	// $[PCA0L - PCA Counter/Timer Low Byte]
	// [PCA0L - PCA Counter/Timer Low Byte]$

	// $[PCA0PWM - PCA PWM Configuration]
	// [PCA0PWM - PCA PWM Configuration]$

	// $[PCA0CN0 - PCA Control 0]
	// [PCA0CN0 - PCA Control 0]$

}

//================================================================================
// ADC_0_enter_ClockMode_from_SleepMode
//================================================================================
extern void ADC_0_enter_ClockMode_from_SleepMode(void) {
	// $[ADC0MX - ADC0 Multiplexer Selection]
	// [ADC0MX - ADC0 Multiplexer Selection]$

	// $[ADC0AC - ADC0 Accumulator Configuration]
	// [ADC0AC - ADC0 Accumulator Configuration]$

	// $[ADC0TK - ADC0 Burst Mode Track Time]
	// [ADC0TK - ADC0 Burst Mode Track Time]$

	// $[ADC0PWR - ADC0 Power Control]
	// [ADC0PWR - ADC0 Power Control]$

	// $[ADC0CF - ADC0 Configuration]
	// [ADC0CF - ADC0 Configuration]$

	// $[ADC0GTH - ADC0 Greater-Than High Byte]
	// [ADC0GTH - ADC0 Greater-Than High Byte]$

	// $[ADC0GTL - ADC0 Greater-Than Low Byte]
	// [ADC0GTL - ADC0 Greater-Than Low Byte]$

	// $[ADC0LTH - ADC0 Less-Than High Byte]
	// [ADC0LTH - ADC0 Less-Than High Byte]$

	// $[ADC0LTL - ADC0 Less-Than Low Byte]
	// [ADC0LTL - ADC0 Less-Than Low Byte]$

	// $[ADC0CN0 - ADC0 Control 0]
	/***********************************************************************
	 - Enable ADC0 
	 ***********************************************************************/
	ADC0CN0 |= ADC0CN0_ADEN__ENABLED;
	// [ADC0CN0 - ADC0 Control 0]$

}

//================================================================================
// PMU_0_enter_ClockMode_from_SleepMode
//================================================================================
extern void PMU_0_enter_ClockMode_from_SleepMode(void) {
	// $[Clock Setup]

	// We must switch to the LPOSC before going into sleep mode
	// Save the clock settings
	uint8_t CLKSEL_save;
	uint8_t HFO0CN_save;
	CLKSEL_save = CLKSEL;
	HFO0CN_save = HFO0CN;

	// Switch to the LPOSC divided by 1
	CLKSEL = CLKSEL_CLKDIV__SYSCLK_DIV_1 | CLKSEL_CLKSL__LPOSC;
	while (!((CLKSEL & CLKSEL_CLKRDY__BMASK) == CLKSEL_CLKRDY__SET))
		;
	HFO0CN &= ~HFO0CN_IOSCEN__BMASK;

	// [Clock Setup]$

	// $[PCON0 - Power Control 0]
	// [PCON0 - Power Control 0]$

	// $[Clear PMU Wake-up flags]
	// [Clear PMU Wake-up flags]$

	// $[PMU0CF - Power Management Unit Configuration]
	/***********************************************************************
	 - Sleep mode not activated
	 - Suspend mode not activated
	 - Clear all wake-up flags
	 - Comparator 0 rising edge did not cause the last wake-up
	 - A Port Match event did not cause the last wake-up
	 - A RTC Alarm did not cause the last wake-up
	 - An RTC oscillator fail event did not cause the last wake-up
	 ***********************************************************************/
	PMU0CF = PMU0CF_SLEEP__NORMAL | PMU0CF_SUSPEND__NORMAL
			| PMU0CF_CLEAR__ALL_FLAGS | PMU0CF_CPT0WK__NOT_SET
			| PMU0CF_PMATWK__NOT_SET | PMU0CF_RTCAWK__NOT_SET
			| PMU0CF_RTCFWK__NOT_SET;
	NOP();
	NOP(); // Delay to update wake-up flags
	// [PMU0CF - Power Management Unit Configuration]$

	// $[Clock Restore]

	// Restore clock settings
	HFO0CN |= (HFO0CN_save & HFO0CN_IOSCEN__BMASK);
	CLKSEL = CLKSEL_save;
	while (!((CLKSEL & CLKSEL_CLKRDY__BMASK) == CLKSEL_CLKRDY__SET))
		;

	// [Clock Restore]$

}

//==============================================================================
// enter_SleepMode_from_ClockMode
//==============================================================================
extern void enter_SleepMode_from_ClockMode(void) {
	// $[Config Calls]
	// Save the SFRPAGE
	uint8_t SFRPAGE_save = SFRPAGE;
	PCA_0_enter_SleepMode_from_ClockMode();
	ADC_0_enter_SleepMode_from_ClockMode();
	PORTS_0_enter_SleepMode_from_ClockMode();
	PBCFG_0_enter_SleepMode_from_ClockMode();
	PMU_0_enter_SleepMode_from_ClockMode();
	// Restore the SFRPAGE
	SFRPAGE = SFRPAGE_save;
	// [Config Calls]$

}

//================================================================================
// PCA_0_enter_SleepMode_from_ClockMode
//================================================================================
extern void PCA_0_enter_SleepMode_from_ClockMode(void) {
	// $[PCA0MD - PCA Mode]
	/***********************************************************************
	 - System clock
	 - PCA continues to function normally while the system controller is in
	 Idle Mode
	 - Disable the CF interrupt
	 - Disable Watchdog Timer
	 - Watchdog Timer Enable unlocked
	 ***********************************************************************/
	SFRPAGE = 0x00;
	PCA0MD = PCA0MD_CPS__SYSCLK | PCA0MD_CIDL__NORMAL
			| PCA0MD_ECF__OVF_INT_DISABLED | PCA0MD_WDTE__DISABLED
			| PCA0MD_WDLCK__UNLOCKED;
	// [PCA0MD - PCA Mode]$

	// $[PCA0H - PCA Counter/Timer High Byte]
	// [PCA0H - PCA Counter/Timer High Byte]$

	// $[PCA0L - PCA Counter/Timer Low Byte]
	// [PCA0L - PCA Counter/Timer Low Byte]$

	// $[PCA0PWM - PCA PWM Configuration]
	// [PCA0PWM - PCA PWM Configuration]$

	// $[PCA0CN0 - PCA Control 0]
	// [PCA0CN0 - PCA Control 0]$

}

//================================================================================
// ADC_0_enter_SleepMode_from_ClockMode
//================================================================================
extern void ADC_0_enter_SleepMode_from_ClockMode(void) {
	// $[ADC0MX - ADC0 Multiplexer Selection]
	// [ADC0MX - ADC0 Multiplexer Selection]$

	// $[ADC0AC - ADC0 Accumulator Configuration]
	// [ADC0AC - ADC0 Accumulator Configuration]$

	// $[ADC0TK - ADC0 Burst Mode Track Time]
	// [ADC0TK - ADC0 Burst Mode Track Time]$

	// $[ADC0PWR - ADC0 Power Control]
	// [ADC0PWR - ADC0 Power Control]$

	// $[ADC0CF - ADC0 Configuration]
	// [ADC0CF - ADC0 Configuration]$

	// $[ADC0GTH - ADC0 Greater-Than High Byte]
	// [ADC0GTH - ADC0 Greater-Than High Byte]$

	// $[ADC0GTL - ADC0 Greater-Than Low Byte]
	// [ADC0GTL - ADC0 Greater-Than Low Byte]$

	// $[ADC0LTH - ADC0 Less-Than High Byte]
	// [ADC0LTH - ADC0 Less-Than High Byte]$

	// $[ADC0LTL - ADC0 Less-Than Low Byte]
	// [ADC0LTL - ADC0 Less-Than Low Byte]$

	// $[ADC0CN0 - ADC0 Control 0]
	/***********************************************************************
	 - Disable ADC0 
	 ***********************************************************************/
	ADC0CN0 &= ~ADC0CN0_ADEN__BMASK;
	// [ADC0CN0 - ADC0 Control 0]$

}

//================================================================================
// PMU_0_enter_SleepMode_from_ClockMode
//================================================================================
extern void PMU_0_enter_SleepMode_from_ClockMode(void) {
	// $[Clock Setup]

	// We must switch to the LPOSC before going into sleep mode
	// Save the clock settings
	uint8_t CLKSEL_save;
	uint8_t HFO0CN_save;
	CLKSEL_save = CLKSEL;
	HFO0CN_save = HFO0CN;

	// Switch to the LPOSC divided by 1
	CLKSEL = CLKSEL_CLKDIV__SYSCLK_DIV_1 | CLKSEL_CLKSL__LPOSC;
	while (!((CLKSEL & CLKSEL_CLKRDY__BMASK) == CLKSEL_CLKRDY__SET))
		;
	HFO0CN &= ~HFO0CN_IOSCEN__BMASK;

	// [Clock Setup]$

	// $[PCON0 - Power Control 0]
	// [PCON0 - Power Control 0]$

	// $[Clear PMU Wake-up flags]
	PMU0CF = PMU0CF_CLEAR__ALL_FLAGS;
	// [Clear PMU Wake-up flags]$

	// $[PMU0CF - Power Management Unit Configuration]
	/***********************************************************************
	 - Place the device in Sleep mode
	 - Suspend mode not activated
	 - Clear all wake-up flags
	 - Comparator 0 rising edge did not cause the last wake-up
	 - A Port Match event caused the last wake-up
	 - A RTC Alarm caused the last wake-up
	 - An RTC oscillator fail event did not cause the last wake-up
	 ***********************************************************************/
	PMU0CF = PMU0CF_SLEEP__START | PMU0CF_SUSPEND__NORMAL
			| PMU0CF_CLEAR__ALL_FLAGS | PMU0CF_CPT0WK__NOT_SET
			| PMU0CF_PMATWK__SET | PMU0CF_RTCAWK__SET | PMU0CF_RTCFWK__NOT_SET;
	NOP();
	NOP(); // Delay to update wake-up flags
	// [PMU0CF - Power Management Unit Configuration]$

	// $[Clock Restore]

	// Restore clock settings
	HFO0CN |= (HFO0CN_save & HFO0CN_IOSCEN__BMASK);
	CLKSEL = CLKSEL_save;
	while (!((CLKSEL & CLKSEL_CLKRDY__BMASK) == CLKSEL_CLKRDY__SET))
		;

	// [Clock Restore]$

}

//==============================================================================
// enter_RunMode_from_ClockMode
//==============================================================================
extern void enter_RunMode_from_ClockMode(void) {
	// $[Config Calls]
	// Save the SFRPAGE
	uint8_t SFRPAGE_save = SFRPAGE;
	PCA_0_enter_RunMode_from_ClockMode();
	PCACH_0_enter_RunMode_from_ClockMode();
	PCACH_1_enter_RunMode_from_ClockMode();
	ADC_0_enter_RunMode_from_ClockMode();
	VREF_0_enter_RunMode_from_ClockMode();
	PBCFG_0_enter_RunMode_from_ClockMode();
	HFOSC_0_enter_RunMode_from_ClockMode();
	CLOCK_0_enter_RunMode_from_ClockMode();
	TIMER01_0_enter_RunMode_from_ClockMode();
	TIMER16_2_enter_RunMode_from_ClockMode();
	TIMER16_3_enter_RunMode_from_ClockMode();
	TIMER_SETUP_0_enter_RunMode_from_ClockMode();
	SMBUS_0_enter_RunMode_from_ClockMode();
	INTERRUPT_0_enter_RunMode_from_ClockMode();
	// Restore the SFRPAGE
	SFRPAGE = SFRPAGE_save;
	// [Config Calls]$

}

//================================================================================
// PCA_0_enter_RunMode_from_ClockMode
//================================================================================
extern void PCA_0_enter_RunMode_from_ClockMode(void) {
	// $[PCA0MD - PCA Mode]
	// [PCA0MD - PCA Mode]$

	// $[PCA0H - PCA Counter/Timer High Byte]
	// [PCA0H - PCA Counter/Timer High Byte]$

	// $[PCA0L - PCA Counter/Timer Low Byte]
	// [PCA0L - PCA Counter/Timer Low Byte]$

	// $[PCA0PWM - PCA PWM Configuration]
	// [PCA0PWM - PCA PWM Configuration]$

	// $[PCA0CN0 - PCA Control 0]
	/***********************************************************************
	 - Start the PCA Counter/Timer running
	 ***********************************************************************/
	SFRPAGE = 0x00;
	PCA0CN0 |= PCA0CN0_CR__RUN;
	// [PCA0CN0 - PCA Control 0]$

}

//================================================================================
// ADC_0_enter_RunMode_from_ClockMode
//================================================================================
extern void ADC_0_enter_RunMode_from_ClockMode(void) {
	// $[ADC0MX - ADC0 Multiplexer Selection]
	// [ADC0MX - ADC0 Multiplexer Selection]$

	// $[ADC0AC - ADC0 Accumulator Configuration]
	// [ADC0AC - ADC0 Accumulator Configuration]$

	// $[ADC0TK - ADC0 Burst Mode Track Time]
	// [ADC0TK - ADC0 Burst Mode Track Time]$

	// $[ADC0PWR - ADC0 Power Control]
	// [ADC0PWR - ADC0 Power Control]$

	// $[ADC0CF - ADC0 Configuration]
	/***********************************************************************
	 - ADC0 operates in 10-bit mode 
	 - The on-chip PGA gain is 1
	 - SAR Clock Divider = 0x03
	 - Normal Track Mode
	 ***********************************************************************/
	ADC0CF = ADC0CF_AD8BE__NORMAL | ADC0CF_ADGN__GAIN_1
			| (0x03 << ADC0CF_ADSC__SHIFT) | ADC0CF_ADTM__TRACK_NORMAL;
	// [ADC0CF - ADC0 Configuration]$

	// $[ADC0GTH - ADC0 Greater-Than High Byte]
	// [ADC0GTH - ADC0 Greater-Than High Byte]$

	// $[ADC0GTL - ADC0 Greater-Than Low Byte]
	// [ADC0GTL - ADC0 Greater-Than Low Byte]$

	// $[ADC0LTH - ADC0 Less-Than High Byte]
	// [ADC0LTH - ADC0 Less-Than High Byte]$

	// $[ADC0LTL - ADC0 Less-Than Low Byte]
	// [ADC0LTL - ADC0 Less-Than Low Byte]$

	// $[ADC0CN0 - ADC0 Control 0]
	// [ADC0CN0 - ADC0 Control 0]$

}

//================================================================================
// VREF_0_enter_RunMode_from_ClockMode
//================================================================================
extern void VREF_0_enter_RunMode_from_ClockMode(void) {
	// $[REF0CN - Voltage Reference Control]
	/***********************************************************************
	 - Enable the Temperature Sensor
	 - The ADC0 ground reference is the GND pin
	 - Internal 1.68 V Precision Voltage Reference disabled and not connected
	 to VREF
	 - The ADC0 voltage reference is the P0.0/VREF pin
	 ***********************************************************************/
	REF0CN = REF0CN_TEMPE__TEMP_ENABLED | REF0CN_GNDSL__GND_PIN
			| REF0CN_REFOE__DISABLED | REF0CN_REFSL__VREF_PIN;
	// [REF0CN - Voltage Reference Control]$

}

//================================================================================
// HFOSC_0_enter_RunMode_from_ClockMode
//================================================================================
extern void HFOSC_0_enter_RunMode_from_ClockMode(void) {
	// $[HFO#CAL - High Frequency Oscillator Calibration]
	// [HFO#CAL - High Frequency Oscillator Calibration]$

	// $[HFO#CN - High Frequency Oscillator Control]
	/***********************************************************************
	 - High Frequency Oscillator enabled
	 ***********************************************************************/
	HFO0CN |= HFO0CN_IOSCEN__ENABLED;
	// [HFO#CN - High Frequency Oscillator Control]$

	// $[Oscillator Ready]
	while ((HFO0CN & HFO0CN_IFRDY__BMASK) == HFO0CN_IFRDY__NOT_SET)
		;
	// [Oscillator Ready]$

}

//================================================================================
// CLOCK_0_enter_RunMode_from_ClockMode
//================================================================================
extern void CLOCK_0_enter_RunMode_from_ClockMode(void) {
	// $[CLKSEL - Clock Select]
	/***********************************************************************
	 - SYSCLK is equal to selected clock source divided by 1
	 - Clock derived from the internal precision High-Frequency Oscillator
	 ***********************************************************************/
	CLKSEL = CLKSEL_CLKDIV__SYSCLK_DIV_1 | CLKSEL_CLKSL__HFOSC;
	// Wait for the clock to be ready
	while ((CLKSEL & CLKSEL_CLKRDY__BMASK) != CLKSEL_CLKRDY__SET)
		;
	// [CLKSEL - Clock Select]$

}

//================================================================================
// TIMER01_0_enter_RunMode_from_ClockMode
//================================================================================
extern void TIMER01_0_enter_RunMode_from_ClockMode(void) {
	// $[Timer Initialization]
	//Save Timer Configuration
	uint8_t TCON_save;
	TCON_save = TCON;
	//Stop Timers
	TCON &= ~TCON_TR0__BMASK & ~TCON_TR1__BMASK;

	// [Timer Initialization]$

	// $[TH0 - Timer 0 High Byte]
	/***********************************************************************
	 - Timer 0 High Byte = 0x80
	 ***********************************************************************/
	TH0 = (0x80 << TH0_TH0__SHIFT);
	// [TH0 - Timer 0 High Byte]$

	// $[TL0 - Timer 0 Low Byte]
	// [TL0 - Timer 0 Low Byte]$

	// $[TH1 - Timer 1 High Byte]
	// [TH1 - Timer 1 High Byte]$

	// $[TL1 - Timer 1 Low Byte]
	// [TL1 - Timer 1 Low Byte]$

	// $[Timer Restoration]
	//Restore Timer Configuration
	TCON |= (TCON_save & TCON_TR0__BMASK) | (TCON_save & TCON_TR1__BMASK);

	// [Timer Restoration]$

}

//================================================================================
// TIMER16_2_enter_RunMode_from_ClockMode
//================================================================================
extern void TIMER16_2_enter_RunMode_from_ClockMode(void) {
	// $[Timer Initialization]
	// Save Timer Configuration
	uint8_t TMR2CN0_TR2_save;
	TMR2CN0_TR2_save = TMR2CN0 & TMR2CN0_TR2__BMASK;
	// Stop Timer
	TMR2CN0 &= ~(TMR2CN0_TR2__BMASK);
	// [Timer Initialization]$

	// $[TMR2CN0 - Timer 2 Control]
	// [TMR2CN0 - Timer 2 Control]$

	// $[TMR2H - Timer 2 High Byte]
	/***********************************************************************
	 - Timer 2 High Byte = 0xFE
	 ***********************************************************************/
	TMR2H = (0xFE << TMR2H_TMR2H__SHIFT);
	// [TMR2H - Timer 2 High Byte]$

	// $[TMR2L - Timer 2 Low Byte]
	/***********************************************************************
	 - Timer 2 Low Byte = 0x68
	 ***********************************************************************/
	TMR2L = (0x68 << TMR2L_TMR2L__SHIFT);
	// [TMR2L - Timer 2 Low Byte]$

	// $[TMR2RLH - Timer 2 Reload High Byte]
	/***********************************************************************
	 - Timer 2 Reload High Byte = 0xFE
	 ***********************************************************************/
	TMR2RLH = (0xFE << TMR2RLH_TMR2RLH__SHIFT);
	// [TMR2RLH - Timer 2 Reload High Byte]$

	// $[TMR2RLL - Timer 2 Reload Low Byte]
	/***********************************************************************
	 - Timer 2 Reload Low Byte = 0x68
	 ***********************************************************************/
	TMR2RLL = (0x68 << TMR2RLL_TMR2RLL__SHIFT);
	// [TMR2RLL - Timer 2 Reload Low Byte]$

	// $[TMR2CN0]
	/***********************************************************************
	 - Start Timer 2 running
	 ***********************************************************************/
	TMR2CN0 |= TMR2CN0_TR2__RUN;
	// [TMR2CN0]$

	// $[Timer Restoration]
	// Restore Timer Configuration
	TMR2CN0 |= TMR2CN0_TR2_save;
	// [Timer Restoration]$

}

//================================================================================
// TIMER_SETUP_0_enter_RunMode_from_ClockMode
//================================================================================
extern void TIMER_SETUP_0_enter_RunMode_from_ClockMode(void) {
	// $[CKCON0 - Clock Control 0]
	/***********************************************************************
	 - System clock divided by 48
	 - Counter/Timer 0 uses the clock defined by the prescale field, SCA
	 - Timer 2 high byte uses the clock defined by T2XCLK in TMR2CN0
	 - Timer 2 low byte uses the clock defined by T2XCLK in TMR2CN0
	 - Timer 3 high byte uses the clock defined by T3XCLK in TMR3CN0
	 - Timer 3 low byte uses the system clock
	 - Timer 1 uses the clock defined by the prescale field, SCA
	 ***********************************************************************/
	CKCON0 = CKCON0_SCA__SYSCLK_DIV_48 | CKCON0_T0M__PRESCALE
			| CKCON0_T2MH__EXTERNAL_CLOCK | CKCON0_T2ML__EXTERNAL_CLOCK
			| CKCON0_T3MH__EXTERNAL_CLOCK | CKCON0_T3ML__SYSCLK
			| CKCON0_T1M__PRESCALE;
	// [CKCON0 - Clock Control 0]$

	// $[TMOD - Timer 0/1 Mode]
	// [TMOD - Timer 0/1 Mode]$

	// $[TCON - Timer 0/1 Control]
	// [TCON - Timer 0/1 Control]$

}

//================================================================================
// SMBUS_0_enter_RunMode_from_ClockMode
//================================================================================
extern void SMBUS_0_enter_RunMode_from_ClockMode(void) {
	// $[SMB0ADR - SMBus 0 Slave Address]
	/***********************************************************************
	 - General Call Address is ignored
	 - SMBus Hardware Slave Address = 0x12
	 ***********************************************************************/
	SMB0ADR = SMB0ADR_GC__IGNORED | (0x12 << SMB0ADR_SLV__SHIFT);
	// [SMB0ADR - SMBus 0 Slave Address]$

	// $[SMB0ADM - SMBus 0 Slave Address Mask]
	/***********************************************************************
	 - Automatic slave address recognition and hardware acknowledge is
	 enabled
	 - SMBus Slave Address Mask = 0x7F
	 ***********************************************************************/
	SMB0ADM = SMB0ADM_EHACK__ADR_ACK_AUTOMATIC | (0x7F << SMB0ADM_SLVM__SHIFT);
	// [SMB0ADM - SMBus 0 Slave Address Mask]$

	// $[SMB0CF - SMBus 0 Configuration]
	/***********************************************************************
	 - Slave states are enabled
	 - Enable the SMBus module
	 - Enable SDA extended setup and hold times
	 ***********************************************************************/
	SMB0CF &= ~SMB0CF_INH__BMASK;
	SMB0CF |= SMB0CF_ENSMB__ENABLED | SMB0CF_EXTHOLD__ENABLED;
	// [SMB0CF - SMBus 0 Configuration]$

}

//================================================================================
// INTERRUPT_0_enter_RunMode_from_ClockMode
//================================================================================
extern void INTERRUPT_0_enter_RunMode_from_ClockMode(void) {
	// $[EIE1 - Extended Interrupt Enable 1]
	/***********************************************************************
	 - Disable ADC0 Conversion Complete interrupt
	 - Disable ADC0 Window Comparison interrupt
	 - Disable CP0 interrupts
	 - Disable CP1 interrupts
	 - Disable all PCA0 interrupts
	 - Enable interrupt requests generated by a RTC Alarm
	 - Enable interrupt requests generated by SMB0
	 - Enable interrupt requests generated by the TF3L or TF3H flags
	 ***********************************************************************/
	EIE1 = EIE1_EADC0__DISABLED | EIE1_EWADC0__DISABLED | EIE1_ECP0__DISABLED
			| EIE1_ECP1__DISABLED | EIE1_EPCA0__DISABLED | EIE1_ERTC0A__ENABLED
			| EIE1_ESMB0__ENABLED | EIE1_ET3__ENABLED;
	// [EIE1 - Extended Interrupt Enable 1]$

	// $[EIP1 - Extended Interrupt Priority 1]
	/***********************************************************************
	 - ADC0 Conversion Complete interrupt set to low priority level
	 - ADC0 Window interrupt set to low priority level
	 - CP0 interrupt set to low priority level
	 - CP1 interrupt set to low priority level
	 - PCA0 interrupt set to low priority level
	 - RTC Alarm interrupt set to high priority level
	 - SMB0 interrupt set to high priority level
	 - Timer 3 interrupts set to high priority level
	 ***********************************************************************/
	EIP1 = EIP1_PADC0__LOW | EIP1_PWADC0__LOW | EIP1_PCP0__LOW | EIP1_PCP1__LOW
			| EIP1_PPCA0__LOW | EIP1_PRTC0A__HIGH | EIP1_PSMB0__HIGH
			| EIP1_PT3__HIGH;
	// [EIP1 - Extended Interrupt Priority 1]$

	// $[IE - Interrupt Enable]
	/***********************************************************************
	 - Enable each interrupt according to its individual mask setting
	 - Disable external interrupt 0
	 - Disable external interrupt 1
	 - Disable all SPI0 interrupts
	 - Enable interrupt requests generated by the TF0 flag
	 - Disable all Timer 1 interrupt
	 - Enable interrupt requests generated by the TF2L or TF2H flags
	 - Disable UART0 interrupt
	 ***********************************************************************/
	IE = IE_EA__ENABLED | IE_EX0__DISABLED | IE_EX1__DISABLED
			| IE_ESPI0__DISABLED | IE_ET0__ENABLED | IE_ET1__DISABLED
			| IE_ET2__ENABLED | IE_ES0__DISABLED;
	// [IE - Interrupt Enable]$

	// $[IP - Interrupt Priority]
	// [IP - Interrupt Priority]$

	// $[EIE2 - Extended Interrupt Enable 2]
	// [EIE2 - Extended Interrupt Enable 2]$

	// $[EIP2 - Extended Interrupt Priority 2]
	// [EIP2 - Extended Interrupt Priority 2]$

}

//==============================================================================
// enter_SleepMode_from_RunMode
//==============================================================================
extern void enter_SleepMode_from_RunMode(void) {
	// $[Config Calls]
	// Save the SFRPAGE
	uint8_t SFRPAGE_save = SFRPAGE;
	PCA_0_enter_SleepMode_from_RunMode();
	PCACH_0_enter_SleepMode_from_RunMode();
	PCACH_1_enter_SleepMode_from_RunMode();
	ADC_0_enter_SleepMode_from_RunMode();
	VREF_0_enter_SleepMode_from_RunMode();
	PORTS_0_enter_SleepMode_from_RunMode();
	PBCFG_0_enter_SleepMode_from_RunMode();
	CLOCK_0_enter_SleepMode_from_RunMode();
	HFOSC_0_enter_SleepMode_from_RunMode();
	TIMER01_0_enter_SleepMode_from_RunMode();
	TIMER16_2_enter_SleepMode_from_RunMode();
	TIMER16_3_enter_SleepMode_from_RunMode();
	TIMER_SETUP_0_enter_SleepMode_from_RunMode();
	SMBUS_0_enter_SleepMode_from_RunMode();
	INTERRUPT_0_enter_SleepMode_from_RunMode();
	PMU_0_enter_SleepMode_from_RunMode();
	// Restore the SFRPAGE
	SFRPAGE = SFRPAGE_save;
	// [Config Calls]$

}

//================================================================================
// PCA_0_enter_SleepMode_from_RunMode
//================================================================================
extern void PCA_0_enter_SleepMode_from_RunMode(void) {
	// $[PCA0MD - PCA Mode]
	/***********************************************************************
	 - System clock
	 - PCA continues to function normally while the system controller is in
	 Idle Mode
	 - Disable the CF interrupt
	 - Disable Watchdog Timer
	 - Watchdog Timer Enable unlocked
	 ***********************************************************************/
	SFRPAGE = 0x00;
	PCA0MD = PCA0MD_CPS__SYSCLK | PCA0MD_CIDL__NORMAL
			| PCA0MD_ECF__OVF_INT_DISABLED | PCA0MD_WDTE__DISABLED
			| PCA0MD_WDLCK__UNLOCKED;
	// [PCA0MD - PCA Mode]$

	// $[PCA0H - PCA Counter/Timer High Byte]
	// [PCA0H - PCA Counter/Timer High Byte]$

	// $[PCA0L - PCA Counter/Timer Low Byte]
	// [PCA0L - PCA Counter/Timer Low Byte]$

	// $[PCA0PWM - PCA PWM Configuration]
	// [PCA0PWM - PCA PWM Configuration]$

	// $[PCA0CN0 - PCA Control 0]
	/***********************************************************************
	 - Stop the PCA Counter/Timer
	 ***********************************************************************/
	PCA0CN0 &= ~PCA0CN0_CR__BMASK;
	// [PCA0CN0 - PCA Control 0]$

}

//================================================================================
// ADC_0_enter_SleepMode_from_RunMode
//================================================================================
extern void ADC_0_enter_SleepMode_from_RunMode(void) {
	// $[ADC0MX - ADC0 Multiplexer Selection]
	// [ADC0MX - ADC0 Multiplexer Selection]$

	// $[ADC0AC - ADC0 Accumulator Configuration]
	// [ADC0AC - ADC0 Accumulator Configuration]$

	// $[ADC0TK - ADC0 Burst Mode Track Time]
	// [ADC0TK - ADC0 Burst Mode Track Time]$

	// $[ADC0PWR - ADC0 Power Control]
	// [ADC0PWR - ADC0 Power Control]$

	// $[ADC0CF - ADC0 Configuration]
	/***********************************************************************
	 - ADC0 operates in 10-bit mode 
	 - The on-chip PGA gain is 1
	 - SAR Clock Divider = 0x02
	 - Normal Track Mode
	 ***********************************************************************/
	ADC0CF = ADC0CF_AD8BE__NORMAL | ADC0CF_ADGN__GAIN_1
			| (0x02 << ADC0CF_ADSC__SHIFT) | ADC0CF_ADTM__TRACK_NORMAL;
	// [ADC0CF - ADC0 Configuration]$

	// $[ADC0GTH - ADC0 Greater-Than High Byte]
	// [ADC0GTH - ADC0 Greater-Than High Byte]$

	// $[ADC0GTL - ADC0 Greater-Than Low Byte]
	// [ADC0GTL - ADC0 Greater-Than Low Byte]$

	// $[ADC0LTH - ADC0 Less-Than High Byte]
	// [ADC0LTH - ADC0 Less-Than High Byte]$

	// $[ADC0LTL - ADC0 Less-Than Low Byte]
	// [ADC0LTL - ADC0 Less-Than Low Byte]$

	// $[ADC0CN0 - ADC0 Control 0]
	/***********************************************************************
	 - Disable ADC0 
	 ***********************************************************************/
	ADC0CN0 &= ~ADC0CN0_ADEN__BMASK;
	// [ADC0CN0 - ADC0 Control 0]$

}

//================================================================================
// VREF_0_enter_SleepMode_from_RunMode
//================================================================================
extern void VREF_0_enter_SleepMode_from_RunMode(void) {
	// $[REF0CN - Voltage Reference Control]
	/***********************************************************************
	 - Disable the Temperature Sensor
	 - The ADC0 ground reference is the GND pin
	 - Internal 1.68 V Precision Voltage Reference disabled and not connected
	 to VREF
	 - The ADC0 voltage reference is the P0.0/VREF pin
	 ***********************************************************************/
	REF0CN = REF0CN_TEMPE__TEMP_DISABLED | REF0CN_GNDSL__GND_PIN
			| REF0CN_REFOE__DISABLED | REF0CN_REFSL__VREF_PIN;
	// [REF0CN - Voltage Reference Control]$

}

//================================================================================
// CLOCK_0_enter_SleepMode_from_RunMode
//================================================================================
extern void CLOCK_0_enter_SleepMode_from_RunMode(void) {
	// $[CLKSEL - Clock Select]
	/***********************************************************************
	 - SYSCLK is equal to selected clock source divided by 1
	 - Clock derived from the Internal Low Power Oscillator
	 ***********************************************************************/
	CLKSEL = CLKSEL_CLKDIV__SYSCLK_DIV_1 | CLKSEL_CLKSL__LPOSC;
	// Wait for the clock to be ready
	while ((CLKSEL & CLKSEL_CLKRDY__BMASK) != CLKSEL_CLKRDY__SET)
		;
	// [CLKSEL - Clock Select]$

}

//================================================================================
// HFOSC_0_enter_SleepMode_from_RunMode
//================================================================================
extern void HFOSC_0_enter_SleepMode_from_RunMode(void) {
	// $[HFO#CAL - High Frequency Oscillator Calibration]
	// [HFO#CAL - High Frequency Oscillator Calibration]$

	// $[HFO#CN - High Frequency Oscillator Control]
	/***********************************************************************
	 - High Frequency Oscillator disabled
	 ***********************************************************************/
	HFO0CN &= ~HFO0CN_IOSCEN__BMASK;
	// [HFO#CN - High Frequency Oscillator Control]$

	// $[Oscillator Ready]
	// [Oscillator Ready]$

}

//================================================================================
// TIMER01_0_enter_SleepMode_from_RunMode
//================================================================================
extern void TIMER01_0_enter_SleepMode_from_RunMode(void) {
	// $[Timer Initialization]
	//Save Timer Configuration
	uint8_t TCON_save;
	TCON_save = TCON;
	//Stop Timers
	TCON &= ~TCON_TR0__BMASK & ~TCON_TR1__BMASK;

	// [Timer Initialization]$

	// $[TH0 - Timer 0 High Byte]
	/***********************************************************************
	 - Timer 0 High Byte = 0x00
	 ***********************************************************************/
	TH0 = (0x00 << TH0_TH0__SHIFT);
	// [TH0 - Timer 0 High Byte]$

	// $[TL0 - Timer 0 Low Byte]
	// [TL0 - Timer 0 Low Byte]$

	// $[TH1 - Timer 1 High Byte]
	// [TH1 - Timer 1 High Byte]$

	// $[TL1 - Timer 1 Low Byte]
	// [TL1 - Timer 1 Low Byte]$

	// $[Timer Restoration]
	//Restore Timer Configuration
	TCON |= (TCON_save & TCON_TR0__BMASK) | (TCON_save & TCON_TR1__BMASK);

	// [Timer Restoration]$

}

//================================================================================
// TIMER16_2_enter_SleepMode_from_RunMode
//================================================================================
extern void TIMER16_2_enter_SleepMode_from_RunMode(void) {
	// $[Timer Initialization]
	// Save Timer Configuration
	uint8_t TMR2CN0_TR2_save;
	TMR2CN0_TR2_save = TMR2CN0 & TMR2CN0_TR2__BMASK;
	// Stop Timer
	TMR2CN0 &= ~(TMR2CN0_TR2__BMASK);
	// [Timer Initialization]$

	// $[TMR2CN0 - Timer 2 Control]
	// [TMR2CN0 - Timer 2 Control]$

	// $[TMR2H - Timer 2 High Byte]
	/***********************************************************************
	 - Timer 2 High Byte = 0x00
	 ***********************************************************************/
	TMR2H = (0x00 << TMR2H_TMR2H__SHIFT);
	// [TMR2H - Timer 2 High Byte]$

	// $[TMR2L - Timer 2 Low Byte]
	/***********************************************************************
	 - Timer 2 Low Byte = 0x00
	 ***********************************************************************/
	TMR2L = (0x00 << TMR2L_TMR2L__SHIFT);
	// [TMR2L - Timer 2 Low Byte]$

	// $[TMR2RLH - Timer 2 Reload High Byte]
	/***********************************************************************
	 - Timer 2 Reload High Byte = 0x00
	 ***********************************************************************/
	TMR2RLH = (0x00 << TMR2RLH_TMR2RLH__SHIFT);
	// [TMR2RLH - Timer 2 Reload High Byte]$

	// $[TMR2RLL - Timer 2 Reload Low Byte]
	/***********************************************************************
	 - Timer 2 Reload Low Byte = 0x00
	 ***********************************************************************/
	TMR2RLL = (0x00 << TMR2RLL_TMR2RLL__SHIFT);
	// [TMR2RLL - Timer 2 Reload Low Byte]$

	// $[TMR2CN0]
	/***********************************************************************
	 - Stop Timer 2
	 ***********************************************************************/
	TMR2CN0 &= ~TMR2CN0_TR2__BMASK;
	// [TMR2CN0]$

	// $[Timer Restoration]
	// Restore Timer Configuration
	TMR2CN0 |= TMR2CN0_TR2_save;
	// [Timer Restoration]$

}

//================================================================================
// TIMER_SETUP_0_enter_SleepMode_from_RunMode
//================================================================================
extern void TIMER_SETUP_0_enter_SleepMode_from_RunMode(void) {
	// $[CKCON0 - Clock Control 0]
	/***********************************************************************
	 - System clock divided by 12
	 - Counter/Timer 0 uses the system clock
	 - Timer 2 high byte uses the clock defined by T2XCLK in TMR2CN0
	 - Timer 2 low byte uses the clock defined by T2XCLK in TMR2CN0
	 - Timer 3 high byte uses the clock defined by T3XCLK in TMR3CN0
	 - Timer 3 low byte uses the clock defined by T3XCLK in TMR3CN0
	 - Timer 1 uses the clock defined by the prescale field, SCA
	 ***********************************************************************/
	CKCON0 = CKCON0_SCA__SYSCLK_DIV_12 | CKCON0_T0M__SYSCLK
			| CKCON0_T2MH__EXTERNAL_CLOCK | CKCON0_T2ML__EXTERNAL_CLOCK
			| CKCON0_T3MH__EXTERNAL_CLOCK | CKCON0_T3ML__EXTERNAL_CLOCK
			| CKCON0_T1M__PRESCALE;
	// [CKCON0 - Clock Control 0]$

	// $[TMOD - Timer 0/1 Mode]
	// [TMOD - Timer 0/1 Mode]$

	// $[TCON - Timer 0/1 Control]
	// [TCON - Timer 0/1 Control]$

}

//================================================================================
// SMBUS_0_enter_SleepMode_from_RunMode
//================================================================================
extern void SMBUS_0_enter_SleepMode_from_RunMode(void) {
	// $[SMB0ADR - SMBus 0 Slave Address]
	/***********************************************************************
	 - General Call Address is ignored
	 - SMBus Hardware Slave Address = 0x00
	 ***********************************************************************/
	SMB0ADR = SMB0ADR_GC__IGNORED | (0x00 << SMB0ADR_SLV__SHIFT);
	// [SMB0ADR - SMBus 0 Slave Address]$

	// $[SMB0ADM - SMBus 0 Slave Address Mask]
	/***********************************************************************
	 - Firmware must manually acknowledge all incoming address and data bytes
	 - SMBus Slave Address Mask = 0x7F
	 ***********************************************************************/
	SMB0ADM = SMB0ADM_EHACK__ADR_ACK_MANUAL | (0x7F << SMB0ADM_SLVM__SHIFT);
	// [SMB0ADM - SMBus 0 Slave Address Mask]$

	// $[SMB0CF - SMBus 0 Configuration]
	/***********************************************************************
	 - Slave states are inhibited
	 - Disable the SMBus module
	 - Disable SDA extended setup and hold times
	 ***********************************************************************/
	SMB0CF &= ~(SMB0CF_ENSMB__BMASK | SMB0CF_EXTHOLD__BMASK);
	SMB0CF |= SMB0CF_INH__SLAVE_DISABLED;
	// [SMB0CF - SMBus 0 Configuration]$

}

//================================================================================
// INTERRUPT_0_enter_SleepMode_from_RunMode
//================================================================================
extern void INTERRUPT_0_enter_SleepMode_from_RunMode(void) {
	// $[EIE1 - Extended Interrupt Enable 1]
	/***********************************************************************
	 - Disable ADC0 Conversion Complete interrupt
	 - Disable ADC0 Window Comparison interrupt
	 - Disable CP0 interrupts
	 - Disable CP1 interrupts
	 - Disable all PCA0 interrupts
	 - Enable interrupt requests generated by a RTC Alarm
	 - Disable all SMB0 interrupts
	 - Disable Timer 3 interrupts
	 ***********************************************************************/
	EIE1 = EIE1_EADC0__DISABLED | EIE1_EWADC0__DISABLED | EIE1_ECP0__DISABLED
			| EIE1_ECP1__DISABLED | EIE1_EPCA0__DISABLED | EIE1_ERTC0A__ENABLED
			| EIE1_ESMB0__DISABLED | EIE1_ET3__DISABLED;
	// [EIE1 - Extended Interrupt Enable 1]$

	// $[EIP1 - Extended Interrupt Priority 1]
	/***********************************************************************
	 - ADC0 Conversion Complete interrupt set to low priority level
	 - ADC0 Window interrupt set to low priority level
	 - CP0 interrupt set to low priority level
	 - CP1 interrupt set to low priority level
	 - PCA0 interrupt set to low priority level
	 - RTC Alarm interrupt set to high priority level
	 - SMB0 interrupt set to low priority level
	 - Timer 3 interrupts set to low priority level
	 ***********************************************************************/
	EIP1 = EIP1_PADC0__LOW | EIP1_PWADC0__LOW | EIP1_PCP0__LOW | EIP1_PCP1__LOW
			| EIP1_PPCA0__LOW | EIP1_PRTC0A__HIGH | EIP1_PSMB0__LOW
			| EIP1_PT3__LOW;
	// [EIP1 - Extended Interrupt Priority 1]$

	// $[IE - Interrupt Enable]
	/***********************************************************************
	 - Enable each interrupt according to its individual mask setting
	 - Disable external interrupt 0
	 - Disable external interrupt 1
	 - Disable all SPI0 interrupts
	 - Disable all Timer 0 interrupt
	 - Disable all Timer 1 interrupt
	 - Disable Timer 2 interrupt
	 - Disable UART0 interrupt
	 ***********************************************************************/
	IE = IE_EA__ENABLED | IE_EX0__DISABLED | IE_EX1__DISABLED
			| IE_ESPI0__DISABLED | IE_ET0__DISABLED | IE_ET1__DISABLED
			| IE_ET2__DISABLED | IE_ES0__DISABLED;
	// [IE - Interrupt Enable]$

	// $[IP - Interrupt Priority]
	// [IP - Interrupt Priority]$

	// $[EIE2 - Extended Interrupt Enable 2]
	// [EIE2 - Extended Interrupt Enable 2]$

	// $[EIP2 - Extended Interrupt Priority 2]
	// [EIP2 - Extended Interrupt Priority 2]$

}

//================================================================================
// PMU_0_enter_SleepMode_from_RunMode
//================================================================================
extern void PMU_0_enter_SleepMode_from_RunMode(void) {
	// $[Clock Setup]

	// We must switch to the LPOSC before going into sleep mode
	// Save the clock settings
	uint8_t CLKSEL_save;
	uint8_t HFO0CN_save;
	CLKSEL_save = CLKSEL;
	HFO0CN_save = HFO0CN;

	// Switch to the LPOSC divided by 1
	CLKSEL = CLKSEL_CLKDIV__SYSCLK_DIV_1 | CLKSEL_CLKSL__LPOSC;
	while (!((CLKSEL & CLKSEL_CLKRDY__BMASK) == CLKSEL_CLKRDY__SET))
		;
	HFO0CN &= ~HFO0CN_IOSCEN__BMASK;

	// [Clock Setup]$

	// $[PCON0 - Power Control 0]
	// [PCON0 - Power Control 0]$

	// $[Clear PMU Wake-up flags]
	PMU0CF = PMU0CF_CLEAR__ALL_FLAGS;
	// [Clear PMU Wake-up flags]$

	// $[PMU0CF - Power Management Unit Configuration]
	/***********************************************************************
	 - Place the device in Sleep mode
	 - Suspend mode not activated
	 - Clear all wake-up flags
	 - Comparator 0 rising edge did not cause the last wake-up
	 - A Port Match event caused the last wake-up
	 - A RTC Alarm caused the last wake-up
	 - An RTC oscillator fail event did not cause the last wake-up
	 ***********************************************************************/
	PMU0CF = PMU0CF_SLEEP__START | PMU0CF_SUSPEND__NORMAL
			| PMU0CF_CLEAR__ALL_FLAGS | PMU0CF_CPT0WK__NOT_SET
			| PMU0CF_PMATWK__SET | PMU0CF_RTCAWK__SET | PMU0CF_RTCFWK__NOT_SET;
	NOP();
	NOP(); // Delay to update wake-up flags
	// [PMU0CF - Power Management Unit Configuration]$

	// $[Clock Restore]

	// Restore clock settings
	HFO0CN |= (HFO0CN_save & HFO0CN_IOSCEN__BMASK);
	CLKSEL = CLKSEL_save;
	while (!((CLKSEL & CLKSEL_CLKRDY__BMASK) == CLKSEL_CLKRDY__SET))
		;

	// [Clock Restore]$

}

extern void PORTS_0_enter_ClockMode_from_SleepMode(void) {
	// $[P0 - Port 0 Pin Latch]
	// [P0 - Port 0 Pin Latch]$

	// $[P0MDOUT - Port 0 Output Mode]
	// [P0MDOUT - Port 0 Output Mode]$

	// $[P0MDIN - Port 0 Input Mode]
	// [P0MDIN - Port 0 Input Mode]$

	// $[P0SKIP - Port 0 Skip]
	// [P0SKIP - Port 0 Skip]$

	// $[P0MASK - Port 0 Mask]
	/***********************************************************************
	 - P0.0 pin logic value is ignored and will not cause a port mismatch
	 event
	 - P0.1 pin logic value is ignored and will not cause a port mismatch
	 event
	 - P0.2 pin logic value is ignored and will not cause a port mismatch
	 event
	 - P0.3 pin logic value is ignored and will not cause a port mismatch
	 event
	 - P0.4 pin logic value is ignored and will not cause a port mismatch
	 event
	 - P0.5 pin logic value is compared to P0MAT.5
	 - P0.6 pin logic value is ignored and will not cause a port mismatch
	 event
	 - P0.7 pin logic value is ignored and will not cause a port mismatch
	 event
	 ***********************************************************************/
	P0MASK = P0MASK_B0__IGNORED | P0MASK_B1__IGNORED | P0MASK_B2__IGNORED
			| P0MASK_B3__IGNORED | P0MASK_B4__IGNORED | P0MASK_B5__COMPARED
			| P0MASK_B6__IGNORED | P0MASK_B7__IGNORED;
	// [P0MASK - Port 0 Mask]$

	// $[P0MAT - Port 0 Match]
	/***********************************************************************
	 - P0.0 pin logic value is compared with logic HIGH
	 - P0.1 pin logic value is compared with logic HIGH
	 - P0.2 pin logic value is compared with logic HIGH
	 - P0.3 pin logic value is compared with logic HIGH
	 - P0.4 pin logic value is compared with logic HIGH
	 - P0.5 pin logic value is compared with logic LOW
	 - P0.6 pin logic value is compared with logic HIGH
	 - P0.7 pin logic value is compared with logic HIGH
	 ***********************************************************************/
	P0MAT = P0MAT_B0__HIGH | P0MAT_B1__HIGH | P0MAT_B2__HIGH | P0MAT_B3__HIGH
			| P0MAT_B4__HIGH | P0MAT_B5__LOW | P0MAT_B6__HIGH | P0MAT_B7__HIGH;
	// [P0MAT - Port 0 Match]$

	// $[P0DRV - Port 0 Drive Strength]
	// [P0DRV - Port 0 Drive Strength]$

}

extern void PBCFG_0_enter_ClockMode_from_SleepMode(void) {
	// $[XBR2 - Port I/O Crossbar 2]
	/***********************************************************************
	 - Weak Pullups enabled 
	 - Crossbar enabled
	 ***********************************************************************/
	XBR2 = XBR2_WEAKPUD__PULL_UPS_ENABLED | XBR2_XBARE__ENABLED;
	// [XBR2 - Port I/O Crossbar 2]$

	// $[XBR0 - Port I/O Crossbar 0]
	// [XBR0 - Port I/O Crossbar 0]$

	// $[XBR1 - Port I/O Crossbar 1]
	// [XBR1 - Port I/O Crossbar 1]$

}

extern void PORTS_0_enter_SleepMode_from_ClockMode(void) {
	// $[P0 - Port 0 Pin Latch]
	// [P0 - Port 0 Pin Latch]$

	// $[P0MDOUT - Port 0 Output Mode]
	// [P0MDOUT - Port 0 Output Mode]$

	// $[P0MDIN - Port 0 Input Mode]
	// [P0MDIN - Port 0 Input Mode]$

	// $[P0SKIP - Port 0 Skip]
	// [P0SKIP - Port 0 Skip]$

	// $[P0MASK - Port 0 Mask]
	/***********************************************************************
	 - P0.0 pin logic value is ignored and will not cause a port mismatch
	 event
	 - P0.1 pin logic value is ignored and will not cause a port mismatch
	 event
	 - P0.2 pin logic value is ignored and will not cause a port mismatch
	 event
	 - P0.3 pin logic value is ignored and will not cause a port mismatch
	 event
	 - P0.4 pin logic value is ignored and will not cause a port mismatch
	 event
	 - P0.5 pin logic value is ignored and will not cause a port mismatch
	 event
	 - P0.6 pin logic value is ignored and will not cause a port mismatch
	 event
	 - P0.7 pin logic value is compared to P0MAT.7
	 ***********************************************************************/
	P0MASK = P0MASK_B0__IGNORED | P0MASK_B1__IGNORED | P0MASK_B2__IGNORED
			| P0MASK_B3__IGNORED | P0MASK_B4__IGNORED | P0MASK_B5__IGNORED
			| P0MASK_B6__IGNORED | P0MASK_B7__COMPARED;
	// [P0MASK - Port 0 Mask]$

	// $[P0MAT - Port 0 Match]
	/***********************************************************************
	 - P0.0 pin logic value is compared with logic HIGH
	 - P0.1 pin logic value is compared with logic HIGH
	 - P0.2 pin logic value is compared with logic HIGH
	 - P0.3 pin logic value is compared with logic HIGH
	 - P0.4 pin logic value is compared with logic HIGH
	 - P0.5 pin logic value is compared with logic HIGH
	 - P0.6 pin logic value is compared with logic HIGH
	 - P0.7 pin logic value is compared with logic LOW
	 ***********************************************************************/
	P0MAT = P0MAT_B0__HIGH | P0MAT_B1__HIGH | P0MAT_B2__HIGH | P0MAT_B3__HIGH
			| P0MAT_B4__HIGH | P0MAT_B5__HIGH | P0MAT_B6__HIGH | P0MAT_B7__LOW;
	// [P0MAT - Port 0 Match]$

	// $[P0DRV - Port 0 Drive Strength]
	// [P0DRV - Port 0 Drive Strength]$

}

extern void PBCFG_0_enter_SleepMode_from_ClockMode(void) {
	// $[XBR2 - Port I/O Crossbar 2]
	/***********************************************************************
	 - Weak Pullups disabled
	 - Crossbar enabled
	 ***********************************************************************/
	XBR2 = XBR2_WEAKPUD__PULL_UPS_DISABLED | XBR2_XBARE__ENABLED;
	// [XBR2 - Port I/O Crossbar 2]$

	// $[XBR0 - Port I/O Crossbar 0]
	// [XBR0 - Port I/O Crossbar 0]$

	// $[XBR1 - Port I/O Crossbar 1]
	// [XBR1 - Port I/O Crossbar 1]$

}

extern void PBCFG_0_enter_RunMode_from_ClockMode(void) {
	// $[XBR2 - Port I/O Crossbar 2]
	// [XBR2 - Port I/O Crossbar 2]$

	// $[XBR0 - Port I/O Crossbar 0]
	// [XBR0 - Port I/O Crossbar 0]$

	// $[XBR1 - Port I/O Crossbar 1]
	/***********************************************************************
	 - SPI1 I/O unavailable at Port pin
	 - CEX0, CEX1 routed to Port pins
	 - ECI unavailable at Port pin
	 - T0 unavailable at Port pin
	 - T1 unavailable at Port pin
	 ***********************************************************************/
	XBR1 = XBR1_SPI1E__DISABLED | XBR1_PCA0ME__CEX0_CEX1 | XBR1_ECIE__DISABLED
			| XBR1_T0E__DISABLED | XBR1_T1E__DISABLED;
	// [XBR1 - Port I/O Crossbar 1]$

}

extern void PORTS_0_enter_SleepMode_from_RunMode(void) {
	// $[P0 - Port 0 Pin Latch]
	// [P0 - Port 0 Pin Latch]$

	// $[P0MDOUT - Port 0 Output Mode]
	// [P0MDOUT - Port 0 Output Mode]$

	// $[P0MDIN - Port 0 Input Mode]
	// [P0MDIN - Port 0 Input Mode]$

	// $[P0SKIP - Port 0 Skip]
	// [P0SKIP - Port 0 Skip]$

	// $[P0MASK - Port 0 Mask]
	/***********************************************************************
	 - P0.0 pin logic value is ignored and will not cause a port mismatch
	 event
	 - P0.1 pin logic value is ignored and will not cause a port mismatch
	 event
	 - P0.2 pin logic value is ignored and will not cause a port mismatch
	 event
	 - P0.3 pin logic value is ignored and will not cause a port mismatch
	 event
	 - P0.4 pin logic value is ignored and will not cause a port mismatch
	 event
	 - P0.5 pin logic value is ignored and will not cause a port mismatch
	 event
	 - P0.6 pin logic value is ignored and will not cause a port mismatch
	 event
	 - P0.7 pin logic value is compared to P0MAT.7
	 ***********************************************************************/
	P0MASK = P0MASK_B0__IGNORED | P0MASK_B1__IGNORED | P0MASK_B2__IGNORED
			| P0MASK_B3__IGNORED | P0MASK_B4__IGNORED | P0MASK_B5__IGNORED
			| P0MASK_B6__IGNORED | P0MASK_B7__COMPARED;
	// [P0MASK - Port 0 Mask]$

	// $[P0MAT - Port 0 Match]
	/***********************************************************************
	 - P0.0 pin logic value is compared with logic HIGH
	 - P0.1 pin logic value is compared with logic HIGH
	 - P0.2 pin logic value is compared with logic HIGH
	 - P0.3 pin logic value is compared with logic HIGH
	 - P0.4 pin logic value is compared with logic HIGH
	 - P0.5 pin logic value is compared with logic HIGH
	 - P0.6 pin logic value is compared with logic HIGH
	 - P0.7 pin logic value is compared with logic LOW
	 ***********************************************************************/
	P0MAT = P0MAT_B0__HIGH | P0MAT_B1__HIGH | P0MAT_B2__HIGH | P0MAT_B3__HIGH
			| P0MAT_B4__HIGH | P0MAT_B5__HIGH | P0MAT_B6__HIGH | P0MAT_B7__LOW;
	// [P0MAT - Port 0 Match]$

	// $[P0DRV - Port 0 Drive Strength]
	// [P0DRV - Port 0 Drive Strength]$

}

extern void PBCFG_0_enter_SleepMode_from_RunMode(void) {
	// $[XBR2 - Port I/O Crossbar 2]
	/***********************************************************************
	 - Weak Pullups disabled
	 - Crossbar enabled
	 ***********************************************************************/
	XBR2 = XBR2_WEAKPUD__PULL_UPS_DISABLED | XBR2_XBARE__ENABLED;
	// [XBR2 - Port I/O Crossbar 2]$

	// $[XBR0 - Port I/O Crossbar 0]
	// [XBR0 - Port I/O Crossbar 0]$

	// $[XBR1 - Port I/O Crossbar 1]
	/***********************************************************************
	 - SPI1 I/O unavailable at Port pin
	 - All PCA I/O unavailable at Port pins
	 - ECI unavailable at Port pin
	 - T0 unavailable at Port pin
	 - T1 unavailable at Port pin
	 ***********************************************************************/
	XBR1 = XBR1_SPI1E__DISABLED | XBR1_PCA0ME__DISABLED | XBR1_ECIE__DISABLED
			| XBR1_T0E__DISABLED | XBR1_T1E__DISABLED;
	// [XBR1 - Port I/O Crossbar 1]$

}

extern void PCACH_0_enter_RunMode_from_ClockMode(void) {
	// $[PCA0 Settings Save]
	// Select Capture/Compare register)
	PCA0PWM &= ~PCA0PWM_ARSEL__BMASK;
	// [PCA0 Settings Save]$

	// $[PCA0CPM0 - PCA Channel 0 Capture/Compare Mode]
	/***********************************************************************
	 - Disable negative edge capture
	 - Disable CCF0 interrupts
	 - Disable match function
	 - 8 to 11-bit PWM selected
	 - Disable positive edge capture
	 - Enable comparator function
	 - Enable PWM function
	 - Disable toggle function
	 ***********************************************************************/
	PCA0CPM0 = PCA0CPM0_CAPN__DISABLED | PCA0CPM0_ECCF__DISABLED
			| PCA0CPM0_MAT__DISABLED | PCA0CPM0_PWM16__8_BIT
			| PCA0CPM0_CAPP__DISABLED | PCA0CPM0_ECOM__ENABLED
			| PCA0CPM0_PWM__ENABLED | PCA0CPM0_TOG__DISABLED;
	// [PCA0CPM0 - PCA Channel 0 Capture/Compare Mode]$

	// $[PCA0CPL0 - PCA Channel 0 Capture Module Low Byte]
	// [PCA0CPL0 - PCA Channel 0 Capture Module Low Byte]$

	// $[PCA0CPH0 - PCA Channel 0 Capture Module High Byte]
	PCA0CPH0 = 0x00;
	// [PCA0CPH0 - PCA Channel 0 Capture Module High Byte]$

	// $[Auto-reload]
	// [Auto-reload]$

	// $[PCA0 Settings Restore]
	// [PCA0 Settings Restore]$

}

extern void PCACH_1_enter_RunMode_from_ClockMode(void) {
	// $[PCA0 Settings Save]
	// Select Capture/Compare register)
	PCA0PWM &= ~PCA0PWM_ARSEL__BMASK;
	// [PCA0 Settings Save]$

	// $[PCA0CPM1 - PCA Channel 1 Capture/Compare Mode]
	/***********************************************************************
	 - Disable negative edge capture
	 - Disable CCF1 interrupts
	 - Disable match function
	 - 8 to 11-bit PWM selected
	 - Disable positive edge capture
	 - Enable comparator function
	 - Enable PWM function
	 - Disable toggle function
	 ***********************************************************************/
	PCA0CPM1 = PCA0CPM1_CAPN__DISABLED | PCA0CPM1_ECCF__DISABLED
			| PCA0CPM1_MAT__DISABLED | PCA0CPM1_PWM16__8_BIT
			| PCA0CPM1_CAPP__DISABLED | PCA0CPM1_ECOM__ENABLED
			| PCA0CPM1_PWM__ENABLED | PCA0CPM1_TOG__DISABLED;
	// [PCA0CPM1 - PCA Channel 1 Capture/Compare Mode]$

	// $[PCA0CPL1 - PCA Channel 1 Capture Module Low Byte]
	// [PCA0CPL1 - PCA Channel 1 Capture Module Low Byte]$

	// $[PCA0CPH1 - PCA Channel 1 Capture Module High Byte]
	PCA0CPH1 = 0x00;
	// [PCA0CPH1 - PCA Channel 1 Capture Module High Byte]$

	// $[Auto-reload]
	// [Auto-reload]$

	// $[PCA0 Settings Restore]
	// [PCA0 Settings Restore]$

}

extern void PCACH_0_enter_SleepMode_from_RunMode(void) {
	// $[PCA0 Settings Save]
	// Select Capture/Compare register)
	PCA0PWM &= ~PCA0PWM_ARSEL__BMASK;
	// [PCA0 Settings Save]$

	// $[PCA0CPM0 - PCA Channel 0 Capture/Compare Mode]
	/***********************************************************************
	 - Disable negative edge capture
	 - Disable CCF0 interrupts
	 - Disable match function
	 - 8 to 11-bit PWM selected
	 - Disable positive edge capture
	 - Disable comparator function
	 - Disable PWM function
	 - Disable toggle function
	 ***********************************************************************/
	PCA0CPM0 = PCA0CPM0_CAPN__DISABLED | PCA0CPM0_ECCF__DISABLED
			| PCA0CPM0_MAT__DISABLED | PCA0CPM0_PWM16__8_BIT
			| PCA0CPM0_CAPP__DISABLED | PCA0CPM0_ECOM__DISABLED
			| PCA0CPM0_PWM__DISABLED | PCA0CPM0_TOG__DISABLED;
	// [PCA0CPM0 - PCA Channel 0 Capture/Compare Mode]$

	// $[PCA0CPL0 - PCA Channel 0 Capture Module Low Byte]
	// [PCA0CPL0 - PCA Channel 0 Capture Module Low Byte]$

	// $[PCA0CPH0 - PCA Channel 0 Capture Module High Byte]
	PCA0CPH0 = 0x00;
	// [PCA0CPH0 - PCA Channel 0 Capture Module High Byte]$

	// $[Auto-reload]
	// [Auto-reload]$

	// $[PCA0 Settings Restore]
	// [PCA0 Settings Restore]$

}

extern void PCACH_1_enter_SleepMode_from_RunMode(void) {
	// $[PCA0 Settings Save]
	// Select Capture/Compare register)
	PCA0PWM &= ~PCA0PWM_ARSEL__BMASK;
	// [PCA0 Settings Save]$

	// $[PCA0CPM1 - PCA Channel 1 Capture/Compare Mode]
	/***********************************************************************
	 - Disable negative edge capture
	 - Disable CCF1 interrupts
	 - Disable match function
	 - 8 to 11-bit PWM selected
	 - Disable positive edge capture
	 - Disable comparator function
	 - Disable PWM function
	 - Disable toggle function
	 ***********************************************************************/
	PCA0CPM1 = PCA0CPM1_CAPN__DISABLED | PCA0CPM1_ECCF__DISABLED
			| PCA0CPM1_MAT__DISABLED | PCA0CPM1_PWM16__8_BIT
			| PCA0CPM1_CAPP__DISABLED | PCA0CPM1_ECOM__DISABLED
			| PCA0CPM1_PWM__DISABLED | PCA0CPM1_TOG__DISABLED;
	// [PCA0CPM1 - PCA Channel 1 Capture/Compare Mode]$

	// $[PCA0CPL1 - PCA Channel 1 Capture Module Low Byte]
	// [PCA0CPL1 - PCA Channel 1 Capture Module Low Byte]$

	// $[PCA0CPH1 - PCA Channel 1 Capture Module High Byte]
	PCA0CPH1 = 0x00;
	// [PCA0CPH1 - PCA Channel 1 Capture Module High Byte]$

	// $[Auto-reload]
	// [Auto-reload]$

	// $[PCA0 Settings Restore]
	// [PCA0 Settings Restore]$

}

extern void TIMER16_3_enter_RunMode_from_ClockMode(void) {
	// $[Timer Initialization]
	// Save Timer Configuration
	uint8_t TMR3CN0_TR3_save;
	TMR3CN0_TR3_save = TMR3CN0 & TMR3CN0_TR3__BMASK;
	// Stop Timer
	TMR3CN0 &= ~(TMR3CN0_TR3__BMASK);
	// [Timer Initialization]$

	// $[TMR3CN0 - Timer 3 Control]
	// [TMR3CN0 - Timer 3 Control]$

	// $[TMR3H - Timer 3 High Byte]
	// [TMR3H - Timer 3 High Byte]$

	// $[TMR3L - Timer 3 Low Byte]
	// [TMR3L - Timer 3 Low Byte]$

	// $[TMR3RLH - Timer 3 Reload High Byte]
	/***********************************************************************
	 - Timer 3 Reload High Byte = 0xF9
	 ***********************************************************************/
	TMR3RLH = (0xF9 << TMR3RLH_TMR3RLH__SHIFT);
	// [TMR3RLH - Timer 3 Reload High Byte]$

	// $[TMR3RLL - Timer 3 Reload Low Byte]
	/***********************************************************************
	 - Timer 3 Reload Low Byte = 0x4D
	 ***********************************************************************/
	TMR3RLL = (0x4D << TMR3RLL_TMR3RLL__SHIFT);
	// [TMR3RLL - Timer 3 Reload Low Byte]$

	// $[TMR3CN0]
	/***********************************************************************
	 - Start Timer 3 running
	 ***********************************************************************/
	TMR3CN0 |= TMR3CN0_TR3__RUN;
	// [TMR3CN0]$

	// $[Timer Restoration]
	// Restore Timer Configuration
	TMR3CN0 |= TMR3CN0_TR3_save;
	// [Timer Restoration]$

}

extern void TIMER16_3_enter_SleepMode_from_RunMode(void) {
	// $[Timer Initialization]
	// Save Timer Configuration
	uint8_t TMR3CN0_TR3_save;
	TMR3CN0_TR3_save = TMR3CN0 & TMR3CN0_TR3__BMASK;
	// Stop Timer
	TMR3CN0 &= ~(TMR3CN0_TR3__BMASK);
	// [Timer Initialization]$

	// $[TMR3CN0 - Timer 3 Control]
	// [TMR3CN0 - Timer 3 Control]$

	// $[TMR3H - Timer 3 High Byte]
	// [TMR3H - Timer 3 High Byte]$

	// $[TMR3L - Timer 3 Low Byte]
	// [TMR3L - Timer 3 Low Byte]$

	// $[TMR3RLH - Timer 3 Reload High Byte]
	/***********************************************************************
	 - Timer 3 Reload High Byte = 0x00
	 ***********************************************************************/
	TMR3RLH = (0x00 << TMR3RLH_TMR3RLH__SHIFT);
	// [TMR3RLH - Timer 3 Reload High Byte]$

	// $[TMR3RLL - Timer 3 Reload Low Byte]
	/***********************************************************************
	 - Timer 3 Reload Low Byte = 0x00
	 ***********************************************************************/
	TMR3RLL = (0x00 << TMR3RLL_TMR3RLL__SHIFT);
	// [TMR3RLL - Timer 3 Reload Low Byte]$

	// $[TMR3CN0]
	/***********************************************************************
	 - Stop Timer 3
	 ***********************************************************************/
	TMR3CN0 &= ~TMR3CN0_TR3__BMASK;
	// [TMR3CN0]$

	// $[Timer Restoration]
	// Restore Timer Configuration
	TMR3CN0 |= TMR3CN0_TR3_save;
	// [Timer Restoration]$

}

